; f9dasm: M6800/1/2/3/8/9 / H6309 Binary/OS9/FLEX9 Disassembler V1.80
; Loaded binary file mcu.bin

;****************************************************
;* Used Labels                                      *
;****************************************************

M0000   EQU     $0000
M0001   EQU     $0001
M0002   EQU     $0002
M0003   EQU     $0003
M0005   EQU     $0005
M0007   EQU     $0007
M0008   EQU     $0008
M0009   EQU     $0009
M000A   EQU     $000A
M000B   EQU     $000B                    ; not used
M000D   EQU     $000D                    ; not used
M000F   EQU     $000F                    ; not used
M0010   EQU     $0010                    ; not used
M0014   EQU     $0014                    ; not used
M0028   EQU     $0028
M0064   EQU     $0064
M007B   EQU     $007B
track1_loc_word EQU     $0080
track2_loc_word EQU     $0082
track3_loc_word EQU     $0084
opn_ch  EQU     $0086
track1_is_finished EQU     $0087
track2_is_finished EQU     $0088
track3_is_finished EQU     $0089
opn_timer_b EQU     $008A
M008B   EQU     $008B
track1_note_len EQU     $008C
track2_note_len EQU     $008D
track3_note_len EQU     $008E
track1_kon_len EQU     $008F
track2_kon_len EQU     $0090
track3_kon_len EQU     $0091
patch_upload_tmp EQU     $0092
fb_algo_base EQU     $0093
tl_op1_base EQU     $0096                    ; note: stored in order 1234 here!!!
tl_op2_base EQU     $0099                    ; note: stored in order 1234 here!!!
tl_op3_base EQU     $009C                    ; note: stored in order 1234 here!!!
tl_op4_base EQU     $009F                    ; note: stored in order 1234 here!!!
tl_op1  EQU     $00A2                    ; note: stored in order 1234 here!!!
tl_op2  EQU     $00A3                    ; note: stored in order 1234 here!!!
tl_op3  EQU     $00A4                    ; note: stored in order 1234 here!!!
tl_op4  EQU     $00A5                    ; note: stored in order 1234 here!!!
cur_note_freq EQU     $00A6
unused1 EQU     $00A7
opn_tl_modifier EQU     $00A8
card_pointer EQU     $00A9
opn_io_a_val EQU     $00AB
active_card_slot EQU     $00AC
tune_end_delay EQU     $00AD
tune_end_delay_lo EQU     $00AE
M00AF   EQU     $00AF
M00B0   EQU     $00B0                    ; high byte of patch 1 loc???
patch_loc_word EQU     $00B1
int_flag EQU     $00B3
already_playing EQU     $00B4
currently_playing_bitfield EQU     $00B5
pressed_switch_bitfield EQU     $00B6                    ; really just a backup of PORT1
port1_isr_tmp EQU     $00B7
nothing_pressed_in_isr EQU     $00B8
tune_found_ff_flag EQU     $00B9                    ; can use FF instead of FE to terminate tune?
unk_M00BA EQU     $00BA                    ; some temp var, holds a backup of X, -> 00BB
unk_M00BC EQU     $00BC                    ; temp, stored offset into builtin tune or something like that
unk_M00BE EQU     $00BE                    ; temp, some offset on ml301
M00BF   EQU     $00BF
M00C0   EQU     $00C0
M00C1   EQU     $00C1
M00FF   EQU     $00FF
opn_reg EQU     $0100
card_d_data EQU     $0101
card_c_data EQU     $0102
card_b_data EQU     $0103
card_a_data EQU     $0104
card_addr EQU     $0105                    ; 16 bit wide, big endian, latched on hardware
opn_data_ml304 EQU     $0140                    ; MCU A6 -> OPN A0 on hardware??? or something more complicated?

;****************************************************
;* Program Code / Data Areas                        *
;****************************************************

        ORG     $F000

scale_lut FCB     $02,$8D,$02,$B4,$02,$DD  ;F000: 02 8D 02 B4 02 DD '......'
        FCB     $03,$09,$03              ;F006: 03 09 03       '...'
        FCC     "7"                      ;F009: 37             '7'
        FCB     $03                      ;F00A: 03             '.'
        FCC     "h"                      ;F00B: 68             'h'
        FCB     $03,$9C,$03,$D3,$04,$0D  ;F00C: 03 9C 03 D3 04 0D '......'
        FCB     $04                      ;F012: 04             '.'
        FCC     "K"                      ;F013: 4B             'K'
        FCB     $04,$8C,$04,$D1          ;F014: 04 8C 04 D1    '....'
hdlr_RST TIM     #$80,M0007               ;F018: 7B 80 07       '{..'   ml-304 bit
        BNE     ZF020                    ;F01B: 26 03          '&.'
        JMP     ml301_mode               ;F01D: 7E F8 30       '~.0'
ZF020   CLRA                             ;F020: 4F             'O'
        STAA    M0002                    ;F021: 97 02          '..'
        STAA    M0003                    ;F023: 97 03          '..'
        STAA    M0000                    ;F025: 97 00          '..'
        LDAA    #$0D                     ;F027: 86 0D          '..'
        STAA    M0001                    ;F029: 97 01          '..'
        LDAA    #$7F                     ;F02B: 86 7F          '..'
        STAA    M0005                    ;F02D: 97 05          '..'
        LDS     #M00FF                   ;F02F: 8E 00 FF       '...'
        LDAB    #$2D                     ;F032: C6 2D          '.-'
        JSR     opn_write                ;F034: BD F4 90       '...'   prescaler
        LDAB    #$07                     ;F037: C6 07          '..'
        LDAA    #$7F                     ;F039: 86 7F          '..'
        JSR     opn_write                ;F03B: BD F4 90       '...'   ssg enable
        LDAA    #$0F                     ;F03E: 86 0F          '..'    probably all off 1111
        LDAB    #$0E                     ;F040: C6 0E          '..'
        JSR     opn_write                ;F042: BD F4 90       '...'   io a
        CLRA                             ;F045: 4F             'O'
        STAA    opn_ch                   ;F046: 97 86          '..'
        JSR     opn_keyoff               ;F048: BD F5 D2       '...'
        INC     >opn_ch                  ;F04B: 7C 00 86       '|..'
        JSR     opn_keyoff               ;F04E: BD F5 D2       '...'
        INC     >opn_ch                  ;F051: 7C 00 86       '|..'
        JSR     opn_keyoff               ;F054: BD F5 D2       '...'
        AIM     #$F7,M0003               ;F057: 71 F7 03       'q..'
mainloop CLRA                             ;F05A: 4F             'O'
        STAA    int_flag                 ;F05B: 97 B3          '..'
        STAA    already_playing          ;F05D: 97 B4          '..'
        STAA    currently_playing_bitfield ;F05F: 97 B5          '..'
        STAA    pressed_switch_bitfield  ;F061: 97 B6          '..'
        STAA    port1_isr_tmp            ;F063: 97 B7          '..'    redundant, it is written before reading in swi isr
        STAA    nothing_pressed_in_isr   ;F065: 97 B8          '..'
        STAA    tune_found_ff_flag       ;F067: 97 B9          '..'
        TIM     #$80,M0002               ;F069: 7B 80 02       '{..'
        BNE     ZF071                    ;F06C: 26 03          '&.'
        JMP     ZF11E                    ;F06E: 7E F1 1E       '~..'
ZF071   TIM     #$01,M0002               ;F071: 7B 01 02       '{..'
        BNE     ZF079                    ;F074: 26 03          '&.'
        JMP     ZF0AC                    ;F076: 7E F0 AC       '~..'
ZF079   TIM     #$40,M0002               ;F079: 7B 40 02       '{@.'
        BNE     ZF081                    ;F07C: 26 03          '&.'
        JMP     ZF13C                    ;F07E: 7E F1 3C       '~.<'
ZF081   TIM     #$02,M0002               ;F081: 7B 02 02       '{..'
        BNE     ZF089                    ;F084: 26 03          '&.'
        JMP     ZF0C7                    ;F086: 7E F0 C7       '~..'
ZF089   TIM     #$20,M0002               ;F089: 7B 20 02       '{ .'
        BNE     ZF091                    ;F08C: 26 03          '&.'
        JMP     ZF15A                    ;F08E: 7E F1 5A       '~.Z'
ZF091   TIM     #$04,M0002               ;F091: 7B 04 02       '{..'
        BNE     ZF099                    ;F094: 26 03          '&.'
        JMP     ZF0E2                    ;F096: 7E F0 E2       '~..'
ZF099   TIM     #$10,M0002               ;F099: 7B 10 02       '{..'
        BNE     ZF0A1                    ;F09C: 26 03          '&.'
        JMP     ZF178                    ;F09E: 7E F1 78       '~.x'
ZF0A1   TIM     #$08,M0002               ;F0A1: 7B 08 02       '{..'
        BNE     ZF0A9                    ;F0A4: 26 03          '&.'
        JMP     ZF100                    ;F0A6: 7E F1 00       '~..'
ZF0A9   JMP     mainloop                 ;F0A9: 7E F0 5A       '~.Z'
ZF0AC   JSR     spin_delay_100ms         ;F0AC: BD F7 2A       '..*'
        TIM     #$01,M0002               ;F0AF: 7B 01 02       '{..'
        BNE     mainloop                 ;F0B2: 26 A6          '&.'
sel_card_at_104 LDX     #card_a_data             ;F0B4: CE 01 04       '...'
        STX     card_pointer             ;F0B7: DF A9          '..'
        LDAA    #$07                     ;F0B9: 86 07          '..'
        STAA    opn_io_a_val             ;F0BB: 97 AB          '..'
        LDAA    #$00                     ;F0BD: 86 00          '..'
        STAA    active_card_slot         ;F0BF: 97 AC          '..'
        OIM     #$01,pressed_switch_bitfield ;F0C1: 72 01 B6       'r..'
        JMP     ZF196                    ;F0C4: 7E F1 96       '~..'
ZF0C7   JSR     spin_delay_100ms         ;F0C7: BD F7 2A       '..*'
        TIM     #$02,M0002               ;F0CA: 7B 02 02       '{..'
        BNE     mainloop                 ;F0CD: 26 8B          '&.'
sel_card_at_103 LDX     #card_b_data             ;F0CF: CE 01 03       '...'
        STX     card_pointer             ;F0D2: DF A9          '..'
        LDAA    #$0B                     ;F0D4: 86 0B          '..'
        STAA    opn_io_a_val             ;F0D6: 97 AB          '..'
        LDAA    #$03                     ;F0D8: 86 03          '..'
        STAA    active_card_slot         ;F0DA: 97 AC          '..'
        OIM     #$02,pressed_switch_bitfield ;F0DC: 72 02 B6       'r..'
        JMP     ZF196                    ;F0DF: 7E F1 96       '~..'
ZF0E2   JSR     spin_delay_100ms         ;F0E2: BD F7 2A       '..*'
        TIM     #$04,M0002               ;F0E5: 7B 04 02       '{..'
        BEQ     sel_card_at_102          ;F0E8: 27 03          ''.'
        JMP     mainloop                 ;F0EA: 7E F0 5A       '~.Z'
sel_card_at_102 LDX     #card_c_data             ;F0ED: CE 01 02       '...'
        STX     card_pointer             ;F0F0: DF A9          '..'
        LDAA    #$0D                     ;F0F2: 86 0D          '..'
        STAA    opn_io_a_val             ;F0F4: 97 AB          '..'
        LDAA    #$01                     ;F0F6: 86 01          '..'
        STAA    active_card_slot         ;F0F8: 97 AC          '..'
        OIM     #$04,pressed_switch_bitfield ;F0FA: 72 04 B6       'r..'
        JMP     ZF196                    ;F0FD: 7E F1 96       '~..'
ZF100   JSR     spin_delay_100ms         ;F100: BD F7 2A       '..*'
        TIM     #$08,M0002               ;F103: 7B 08 02       '{..'
        BEQ     sel_card_at_101          ;F106: 27 03          ''.'
        JMP     mainloop                 ;F108: 7E F0 5A       '~.Z'
sel_card_at_101 LDX     #card_d_data             ;F10B: CE 01 01       '...'
        STX     card_pointer             ;F10E: DF A9          '..'
        LDAA    #$0E                     ;F110: 86 0E          '..'
        STAA    opn_io_a_val             ;F112: 97 AB          '..'
        LDAA    #$02                     ;F114: 86 02          '..'
        STAA    active_card_slot         ;F116: 97 AC          '..'
        OIM     #$08,pressed_switch_bitfield ;F118: 72 08 B6       'r..'
        JMP     ZF196                    ;F11B: 7E F1 96       '~..'
ZF11E   JSR     spin_delay_100ms         ;F11E: BD F7 2A       '..*'
        TIM     #$80,M0002               ;F121: 7B 80 02       '{..'
        BEQ     sel2_card_at_104         ;F124: 27 03          ''.'
        JMP     mainloop                 ;F126: 7E F0 5A       '~.Z'
sel2_card_at_104 LDX     #card_a_data             ;F129: CE 01 04       '...'
        STX     card_pointer             ;F12C: DF A9          '..'
        LDAA    #$07                     ;F12E: 86 07          '..'
        STAA    opn_io_a_val             ;F130: 97 AB          '..'
        LDAA    #$00                     ;F132: 86 00          '..'
        STAA    active_card_slot         ;F134: 97 AC          '..'
        OIM     #$80,pressed_switch_bitfield ;F136: 72 80 B6       'r..'
        JMP     ZF196                    ;F139: 7E F1 96       '~..'
ZF13C   JSR     spin_delay_100ms         ;F13C: BD F7 2A       '..*'
        TIM     #$40,M0002               ;F13F: 7B 40 02       '{@.'
        BEQ     sel2_card_at_103         ;F142: 27 03          ''.'
        JMP     mainloop                 ;F144: 7E F0 5A       '~.Z'
sel2_card_at_103 LDX     #card_b_data             ;F147: CE 01 03       '...'
        STX     card_pointer             ;F14A: DF A9          '..'
        LDAA    #$0B                     ;F14C: 86 0B          '..'
        STAA    opn_io_a_val             ;F14E: 97 AB          '..'
        LDAA    #$03                     ;F150: 86 03          '..'
        STAA    active_card_slot         ;F152: 97 AC          '..'
        OIM     #$40,pressed_switch_bitfield ;F154: 72 40 B6       'r@.'
        JMP     ZF196                    ;F157: 7E F1 96       '~..'
ZF15A   JSR     spin_delay_100ms         ;F15A: BD F7 2A       '..*'
        TIM     #$20,M0002               ;F15D: 7B 20 02       '{ .'
        BEQ     sel2_card_at_102         ;F160: 27 03          ''.'
        JMP     mainloop                 ;F162: 7E F0 5A       '~.Z'
sel2_card_at_102 LDX     #card_c_data             ;F165: CE 01 02       '...'
        STX     card_pointer             ;F168: DF A9          '..'
        LDAA    #$0D                     ;F16A: 86 0D          '..'
        STAA    opn_io_a_val             ;F16C: 97 AB          '..'
        LDAA    #$01                     ;F16E: 86 01          '..'
        STAA    active_card_slot         ;F170: 97 AC          '..'
        OIM     #$20,pressed_switch_bitfield ;F172: 72 20 B6       'r .'
        JMP     ZF196                    ;F175: 7E F1 96       '~..'
ZF178   JSR     spin_delay_100ms         ;F178: BD F7 2A       '..*'
        TIM     #$10,M0002               ;F17B: 7B 10 02       '{..'
        BEQ     sel2_card_at_101         ;F17E: 27 03          ''.'
        JMP     mainloop                 ;F180: 7E F0 5A       '~.Z'
sel2_card_at_101 LDX     #card_d_data             ;F183: CE 01 01       '...'
        STX     card_pointer             ;F186: DF A9          '..'
        LDAA    #$0E                     ;F188: 86 0E          '..'
        STAA    opn_io_a_val             ;F18A: 97 AB          '..'
        LDAA    #$02                     ;F18C: 86 02          '..'
        STAA    active_card_slot         ;F18E: 97 AC          '..'
        OIM     #$10,pressed_switch_bitfield ;F190: 72 10 B6       'r..'
        JMP     ZF196                    ;F193: 7E F1 96       '~..'
ZF196   CLRA                             ;F196: 4F             'O'
        STAA    currently_playing_bitfield ;F197: 97 B5          '..'
        LDX     #M0000                   ;F199: CE 00 00       '...'
        STX     card_addr                ;F19C: FF 01 05       '...'
        LDX     card_pointer             ;F19F: DE A9          '..'
        TIM     #$80,$00,X               ;F1A1: 6B 80 00       'k..'   card presence detect
        BEQ     ZF1AC                    ;F1A4: 27 06          ''.'
        AIM     #$F7,M0003               ;F1A6: 71 F7 03       'q..'
        JMP     mainloop                 ;F1A9: 7E F0 5A       '~.Z'
ZF1AC   PSHX                             ;F1AC: 3C             '<'
        LDX     #MFFFF                   ;F1AD: CE FF FF       '...'
        STX     M0009                    ;F1B0: DF 09          '..'
        PULX                             ;F1B2: 38             '8'
        OIM     #$04,M0008               ;F1B3: 72 04 08       'r..'
        CLI                              ;F1B6: 0E             '.'
        LDAA    opn_io_a_val             ;F1B7: 96 AB          '..'
        LDAB    #$0E                     ;F1B9: C6 0E          '..'
        JSR     opn_write                ;F1BB: BD F4 90       '...'   io a
        TIM     #$02,active_card_slot    ;F1BE: 7B 02 AC       '{..'   enable TOI
        BEQ     ZF1C6                    ;F1C1: 27 03          ''.'
        OIM     #$01,M0003               ;F1C3: 72 01 03       'r..'   mux select
ZF1C6   TIM     #$01,active_card_slot    ;F1C6: 7B 01 AC       '{..'
        BEQ     ZF1CE                    ;F1C9: 27 03          ''.'
        OIM     #$04,M0003               ;F1CB: 72 04 03       'r..'   mux select
ZF1CE   TIM     #$02,$00,X               ;F1CE: 6B 02 00       'k..'   card header
        BNE     ZF1D9                    ;F1D1: 26 06          '&.'
        AIM     #$F7,M0003               ;F1D3: 71 F7 03       'q..'   relay off
        JMP     ZF20F                    ;F1D6: 7E F2 0F       '~..'   jmp skip start delay
ZF1D9   OIM     #$08,M0003               ;F1D9: 72 08 03       'r..'   relay on
        LDAB    #$0F                     ;F1DC: C6 0F          '..'    io b
        JSR     opn_read                 ;F1DE: BD F4 AF       '...'   read start delay bits
        BITA    #$20                     ;F1E1: 85 20          '. '
        BEQ     ZF1EB                    ;F1E3: 27 06          ''.'
        BITA    #$40                     ;F1E5: 85 40          '.@'
        BEQ     ZF1FD                    ;F1E7: 27 14          ''.'
        BRA     ZF20F                    ;F1E9: 20 24          ' $'
ZF1EB   LDAA    #$28                     ;F1EB: 86 28          '.('
ZF1ED   TIM     #$01,already_playing     ;F1ED: 7B 01 B4       '{..'
        BEQ     ZF1F5                    ;F1F0: 27 03          ''.'
        JMP     ZF3E3                    ;F1F2: 7E F3 E3       '~..'
ZF1F5   JSR     spin_delay_100ms         ;F1F5: BD F7 2A       '..*'
        DECA                             ;F1F8: 4A             'J'
        BNE     ZF1ED                    ;F1F9: 26 F2          '&.'
        BRA     ZF20F                    ;F1FB: 20 12          ' .'
ZF1FD   LDAA    #$14                     ;F1FD: 86 14          '..'
ZF1FF   TIM     #$01,already_playing     ;F1FF: 7B 01 B4       '{..'
        BEQ     ZF207                    ;F202: 27 03          ''.'
        JMP     ZF3E3                    ;F204: 7E F3 E3       '~..'
ZF207   JSR     spin_delay_100ms         ;F207: BD F7 2A       '..*'
        DECA                             ;F20A: 4A             'J'
        BNE     ZF1FF                    ;F20B: 26 F2          '&.'
        BRA     ZF20F                    ;F20D: 20 00          ' .'
ZF20F   LDX     #M0001                   ;F20F: CE 00 01       '...'
        STX     card_addr                ;F212: FF 01 05       '...'
        JSR     read_tune_data           ;F215: BD F4 CB       '...'
        STAA    tune_end_delay           ;F218: 97 AD          '..'
        INX                              ;F21A: 08             '.'
        STX     card_addr                ;F21B: FF 01 05       '...'
        JSR     read_tune_data           ;F21E: BD F4 CB       '...'
        STAA    tune_end_delay_lo        ;F221: 97 AE          '..'
        INX                              ;F223: 08             '.'
        STX     card_addr                ;F224: FF 01 05       '...'
        JSR     read_tune_data           ;F227: BD F4 CB       '...'
        STAA    M00B0                    ;F22A: 97 B0          '..'
        JMP     ZF22F                    ;F22C: 7E F2 2F       '~./'
ZF22F   CLRA                             ;F22F: 4F             'O'
        STAA    track1_note_len          ;F230: 97 8C          '..'
        STAA    track2_note_len          ;F232: 97 8D          '..'
        STAA    track3_note_len          ;F234: 97 8E          '..'
        STAA    track1_kon_len           ;F236: 97 8F          '..'
        STAA    track2_kon_len           ;F238: 97 90          '..'
        STAA    track3_kon_len           ;F23A: 97 91          '..'
        LDX     #M000B                   ;F23C: CE 00 0B       '...'   track 1 loc
        STX     card_addr                ;F23F: FF 01 05       '...'
        JSR     read_tune_data           ;F242: BD F4 CB       '...'
        TAB                              ;F245: 16             '.'
        DEX                              ;F246: 09             '.'
        STX     card_addr                ;F247: FF 01 05       '...'
        JSR     read_tune_data           ;F24A: BD F4 CB       '...'
        STD     track1_loc_word          ;F24D: DD 80          '..'
        BNE     ZF254                    ;F24F: 26 03          '&.'
        JMP     ZF2EC                    ;F251: 7E F2 EC       '~..'
ZF254   LDAA    #$00                     ;F254: 86 00          '..'
        STAA    opn_ch                   ;F256: 97 86          '..'
        LDX     #M0005                   ;F258: CE 00 05       '...'   patch 1 loc
        STX     card_addr                ;F25B: FF 01 05       '...'
        JSR     read_tune_data           ;F25E: BD F4 CB       '...'
        TAB                              ;F261: 16             '.'
        DEX                              ;F262: 09             '.'
        STX     card_addr                ;F263: FF 01 05       '...'
        JSR     read_tune_data           ;F266: BD F4 CB       '...'
        STD     patch_loc_word           ;F269: DD B1          '..'
        JSR     ZF4D2                    ;F26B: BD F4 D2       '...'
        CLRA                             ;F26E: 4F             'O'
        STAA    track1_is_finished       ;F26F: 97 87          '..'
ZF271   LDX     #M000D                   ;F271: CE 00 0D       '...'   track 2 loc
        STX     card_addr                ;F274: FF 01 05       '...'
        JSR     read_tune_data           ;F277: BD F4 CB       '...'
        TAB                              ;F27A: 16             '.'
        DEX                              ;F27B: 09             '.'
        STX     card_addr                ;F27C: FF 01 05       '...'
        JSR     read_tune_data           ;F27F: BD F4 CB       '...'
        STD     track2_loc_word          ;F282: DD 82          '..'
        BEQ     ZF2F3                    ;F284: 27 6D          ''m'
        LDAA    #$01                     ;F286: 86 01          '..'
        STAA    opn_ch                   ;F288: 97 86          '..'
        LDX     #M0007                   ;F28A: CE 00 07       '...'   patch 2 loc
        STX     card_addr                ;F28D: FF 01 05       '...'
        JSR     read_tune_data           ;F290: BD F4 CB       '...'
        TAB                              ;F293: 16             '.'
        DEX                              ;F294: 09             '.'
        STX     card_addr                ;F295: FF 01 05       '...'
        JSR     read_tune_data           ;F298: BD F4 CB       '...'
        STD     patch_loc_word           ;F29B: DD B1          '..'
        JSR     ZF4D2                    ;F29D: BD F4 D2       '...'
        CLRA                             ;F2A0: 4F             'O'
        STAA    track2_is_finished       ;F2A1: 97 88          '..'
ZF2A3   LDX     #M000F                   ;F2A3: CE 00 0F       '...'   track 3 loc
        STX     card_addr                ;F2A6: FF 01 05       '...'
        JSR     read_tune_data           ;F2A9: BD F4 CB       '...'
        TAB                              ;F2AC: 16             '.'
        DEX                              ;F2AD: 09             '.'
        STX     card_addr                ;F2AE: FF 01 05       '...'
        JSR     read_tune_data           ;F2B1: BD F4 CB       '...'
        STD     track3_loc_word          ;F2B4: DD 84          '..'
        BEQ     ZF2FA                    ;F2B6: 27 42          ''B'
        LDAA    #$02                     ;F2B8: 86 02          '..'
        STAA    opn_ch                   ;F2BA: 97 86          '..'
        LDX     #M0009                   ;F2BC: CE 00 09       '...'   patch 3 loc
        STX     card_addr                ;F2BF: FF 01 05       '...'
        JSR     read_tune_data           ;F2C2: BD F4 CB       '...'
        TAB                              ;F2C5: 16             '.'
        DEX                              ;F2C6: 09             '.'
        STX     card_addr                ;F2C7: FF 01 05       '...'
        JSR     read_tune_data           ;F2CA: BD F4 CB       '...'
        STD     patch_loc_word           ;F2CD: DD B1          '..'
        JSR     ZF4D2                    ;F2CF: BD F4 D2       '...'
        CLRA                             ;F2D2: 4F             'O'
        STAA    track3_is_finished       ;F2D3: 97 89          '..'
ZF2D5   LDX     #M0010                   ;F2D5: CE 00 10       '...'   timer B val
        STX     card_addr                ;F2D8: FF 01 05       '...'
        JSR     read_tune_data           ;F2DB: BD F4 CB       '...'
        STAA    opn_timer_b              ;F2DE: 97 8A          '..'
        JSR     opn_timerb_setup         ;F2E0: BD F6 04       '...'
        LDAA    #$2A                     ;F2E3: 86 2A          '.*'
        LDAB    #$27                     ;F2E5: C6 27          '.''
        JSR     opn_write                ;F2E7: BD F4 90       '...'   write timer A/B control and 3ch mode
        BRA     ZF301                    ;F2EA: 20 15          ' .'
ZF2EC   LDAA    #$FF                     ;F2EC: 86 FF          '..'
        STAA    track1_is_finished       ;F2EE: 97 87          '..'
        JMP     ZF271                    ;F2F0: 7E F2 71       '~.q'
ZF2F3   LDAA    #$FF                     ;F2F3: 86 FF          '..'
        STAA    track2_is_finished       ;F2F5: 97 88          '..'
        JMP     ZF2A3                    ;F2F7: 7E F2 A3       '~..'
ZF2FA   LDAA    #$FF                     ;F2FA: 86 FF          '..'
        STAA    track3_is_finished       ;F2FC: 97 89          '..'
        JMP     ZF2D5                    ;F2FE: 7E F2 D5       '~..'
ZF301   OIM     #$01,int_flag            ;F301: 72 01 B3       'r..'
        WAI                              ;F304: 3E             '>'
        TIM     #$01,int_flag            ;F305: 7B 01 B3       '{..'
        BNE     ZF301                    ;F308: 26 F7          '&.'
        LDAA    already_playing          ;F30A: 96 B4          '..'
        BEQ     ZF311                    ;F30C: 27 03          ''.'
        JMP     ZF3E3                    ;F30E: 7E F3 E3       '~..'
ZF311   LDAA    #$00                     ;F311: 86 00          '..'
        STAA    opn_ch                   ;F313: 97 86          '..'
        LDAA    track1_note_len          ;F315: 96 8C          '..'
        BNE     ZF327                    ;F317: 26 0E          '&.'
        LDAA    track1_is_finished       ;F319: 96 87          '..'
        BNE     ZF32E                    ;F31B: 26 11          '&.'
        JSR     ml304_setup_next_note_trk1 ;F31D: BD F6 48       '..H'
        LDAA    tune_found_ff_flag       ;F320: 96 B9          '..'
        BEQ     ZF327                    ;F322: 27 03          ''.'
        JMP     stop_track               ;F324: 7E F4 60       '~.`'
ZF327   LDAA    track1_kon_len           ;F327: 96 8F          '..'
        BNE     ZF32E                    ;F329: 26 03          '&.'
        JSR     opn_keyoff               ;F32B: BD F5 D2       '...'
ZF32E   LDAA    #$01                     ;F32E: 86 01          '..'
        STAA    opn_ch                   ;F330: 97 86          '..'
        LDAA    track2_note_len          ;F332: 96 8D          '..'
        BNE     ZF344                    ;F334: 26 0E          '&.'
        LDAA    track2_is_finished       ;F336: 96 88          '..'
        BNE     ZF34B                    ;F338: 26 11          '&.'
        JSR     ml304_setup_next_note_trk2 ;F33A: BD F6 8F       '...'
        LDAA    tune_found_ff_flag       ;F33D: 96 B9          '..'
        BEQ     ZF344                    ;F33F: 27 03          ''.'
        JMP     stop_track               ;F341: 7E F4 60       '~.`'
ZF344   LDAA    track2_kon_len           ;F344: 96 90          '..'
        BNE     ZF34B                    ;F346: 26 03          '&.'
        JSR     opn_keyoff               ;F348: BD F5 D2       '...'
ZF34B   LDAA    #$02                     ;F34B: 86 02          '..'
        STAA    opn_ch                   ;F34D: 97 86          '..'
        LDAA    track3_note_len          ;F34F: 96 8E          '..'
        BNE     ZF361                    ;F351: 26 0E          '&.'
        LDAA    track3_is_finished       ;F353: 96 89          '..'
        BNE     ZF368                    ;F355: 26 11          '&.'
        JSR     ml304_setup_next_note_trk3 ;F357: BD F6 D6       '...'
        LDAA    tune_found_ff_flag       ;F35A: 96 B9          '..'
        BEQ     ZF361                    ;F35C: 27 03          ''.'
        JMP     stop_track               ;F35E: 7E F4 60       '~.`'
ZF361   LDAA    track3_kon_len           ;F361: 96 91          '..'
        BNE     ZF368                    ;F363: 26 03          '&.'
        JSR     opn_keyoff               ;F365: BD F5 D2       '...'
ZF368   LDAA    track1_is_finished       ;F368: 96 87          '..'
        BEQ     ZF301                    ;F36A: 27 95          ''.'
        LDAA    track2_is_finished       ;F36C: 96 88          '..'
        BEQ     ZF301                    ;F36E: 27 91          ''.'
        LDAA    track3_is_finished       ;F370: 96 89          '..'
        BEQ     ZF301                    ;F372: 27 8D          ''.'
        LDAA    #$28                     ;F374: 86 28          '.('
        LDAB    #$27                     ;F376: C6 27          '.''
        JSR     opn_write                ;F378: BD F4 90       '...'   clear timer b flag, stop timer b
        LDAA    M00B0                    ;F37B: 96 B0          '..'
        BEQ     ZF397                    ;F37D: 27 18          ''.'
        STAA    M00AF                    ;F37F: 97 AF          '..'
ZF381   LDX     #M000A                   ;F381: CE 00 0A       '...'
ZF384   TIM     #$01,already_playing     ;F384: 7B 01 B4       '{..'
        BEQ     ZF38C                    ;F387: 27 03          ''.'
        JMP     ZF3E3                    ;F389: 7E F3 E3       '~..'
ZF38C   JSR     spin_delay_100ms         ;F38C: BD F7 2A       '..*'
        DEX                              ;F38F: 09             '.'
        BNE     ZF384                    ;F390: 26 F2          '&.'
        DEC     >M00AF                   ;F392: 7A 00 AF       'z..'
        BNE     ZF381                    ;F395: 26 EA          '&.'
ZF397   LDX     #M0000                   ;F397: CE 00 00       '...'
        STX     card_addr                ;F39A: FF 01 05       '...'
        LDX     card_pointer             ;F39D: DE A9          '..'
        TIM     #$01,$00,X               ;F39F: 6B 01 00       'k..'
        BNE     ZF3C8                    ;F3A2: 26 24          '&$'
        DEC     >tune_end_delay          ;F3A4: 7A 00 AD       'z..'
        BEQ     ZF3C8                    ;F3A7: 27 1F          ''.'
        LDAA    tune_end_delay_lo        ;F3A9: 96 AE          '..'
        BEQ     ZF3C5                    ;F3AB: 27 18          ''.'
        STAA    M00AF                    ;F3AD: 97 AF          '..'
ZF3AF   LDX     #M000A                   ;F3AF: CE 00 0A       '...'
ZF3B2   TIM     #$01,already_playing     ;F3B2: 7B 01 B4       '{..'
        BEQ     ZF3BA                    ;F3B5: 27 03          ''.'
        JMP     ZF3E3                    ;F3B7: 7E F3 E3       '~..'
ZF3BA   JSR     spin_delay_100ms         ;F3BA: BD F7 2A       '..*'
        DEX                              ;F3BD: 09             '.'
        BNE     ZF3B2                    ;F3BE: 26 F2          '&.'
        DEC     >M00AF                   ;F3C0: 7A 00 AF       'z..'
        BNE     ZF3AF                    ;F3C3: 26 EA          '&.'
ZF3C5   JMP     ZF22F                    ;F3C5: 7E F2 2F       '~./'
ZF3C8   LDAA    M0002                    ;F3C8: 96 02          '..'
        COMA                             ;F3CA: 43             'C'
        BNE     ZF3D0                    ;F3CB: 26 03          '&.'
        AIM     #$F7,M0003               ;F3CD: 71 F7 03       'q..'
ZF3D0   AIM     #$FE,M0003               ;F3D0: 71 FE 03       'q..'
        AIM     #$FB,M0003               ;F3D3: 71 FB 03       'q..'
        LDAA    #$0F                     ;F3D6: 86 0F          '..'    probably all off 1111
        LDAB    #$0E                     ;F3D8: C6 0E          '..'
        JSR     opn_write                ;F3DA: BD F4 90       '...'   io a
        AIM     #$FB,M0008               ;F3DD: 71 FB 08       'q..'   disable TOI
        JMP     mainloop                 ;F3E0: 7E F0 5A       '~.Z'
ZF3E3   LDAA    #$00                     ;F3E3: 86 00          '..'
        STAA    opn_ch                   ;F3E5: 97 86          '..'
        JSR     opn_keyoff               ;F3E7: BD F5 D2       '...'
        INC     >opn_ch                  ;F3EA: 7C 00 86       '|..'
        JSR     opn_keyoff               ;F3ED: BD F5 D2       '...'
        INC     >opn_ch                  ;F3F0: 7C 00 86       '|..'
        JSR     opn_keyoff               ;F3F3: BD F5 D2       '...'
        LDAA    #$28                     ;F3F6: 86 28          '.('
        LDAB    #$27                     ;F3F8: C6 27          '.''
        JSR     opn_write                ;F3FA: BD F4 90       '...'   write timer A/B control and 3ch mode
        LDX     #M0005                   ;F3FD: CE 00 05       '...'
ZF400   JSR     spin_delay_100ms         ;F400: BD F7 2A       '..*'
        DEX                              ;F403: 09             '.'
        BNE     ZF400                    ;F404: 26 FA          '&.'
        AIM     #$FE,M0003               ;F406: 71 FE 03       'q..'
        AIM     #$FB,M0003               ;F409: 71 FB 03       'q..'
        LDAA    #$0F                     ;F40C: 86 0F          '..'    probably all off 1111
        LDAB    #$0E                     ;F40E: C6 0E          '..'
        JSR     opn_write                ;F410: BD F4 90       '...'   io a
        AIM     #$FB,M0008               ;F413: 71 FB 08       'q..'   disable TOI
        CLRA                             ;F416: 4F             'O'
        STAA    already_playing          ;F417: 97 B4          '..'
        STAA    int_flag                 ;F419: 97 B3          '..'
        STAA    pressed_switch_bitfield  ;F41B: 97 B6          '..'
        TIM     #$80,currently_playing_bitfield ;F41D: 7B 80 B5       '{..'   big tree to check if trying to play same card already playing?
        BEQ     ZF425                    ;F420: 27 03          ''.'
        JMP     sel2_card_at_104         ;F422: 7E F1 29       '~.)'
ZF425   TIM     #$01,currently_playing_bitfield ;F425: 7B 01 B5       '{..'
        BEQ     ZF42D                    ;F428: 27 03          ''.'
        JMP     sel_card_at_104          ;F42A: 7E F0 B4       '~..'
ZF42D   TIM     #$40,currently_playing_bitfield ;F42D: 7B 40 B5       '{@.'
        BEQ     ZF435                    ;F430: 27 03          ''.'
        JMP     sel2_card_at_103         ;F432: 7E F1 47       '~.G'
ZF435   TIM     #$02,currently_playing_bitfield ;F435: 7B 02 B5       '{..'
        BEQ     ZF43D                    ;F438: 27 03          ''.'
        JMP     sel_card_at_103          ;F43A: 7E F0 CF       '~..'
ZF43D   TIM     #$20,currently_playing_bitfield ;F43D: 7B 20 B5       '{ .'
        BEQ     ZF445                    ;F440: 27 03          ''.'
        JMP     sel2_card_at_102         ;F442: 7E F1 65       '~.e'
ZF445   TIM     #$04,currently_playing_bitfield ;F445: 7B 04 B5       '{..'
        BEQ     ZF44D                    ;F448: 27 03          ''.'
        JMP     sel_card_at_102          ;F44A: 7E F0 ED       '~..'
ZF44D   TIM     #$10,currently_playing_bitfield ;F44D: 7B 10 B5       '{..'
        BEQ     ZF455                    ;F450: 27 03          ''.'
        JMP     sel2_card_at_101         ;F452: 7E F1 83       '~..'
ZF455   TIM     #$08,currently_playing_bitfield ;F455: 7B 08 B5       '{..'
        BEQ     ZF45D                    ;F458: 27 03          ''.'
        JMP     sel_card_at_101          ;F45A: 7E F1 0B       '~..'
ZF45D   JMP     mainloop                 ;F45D: 7E F0 5A       '~.Z'
stop_track LDAA    #$00                     ;F460: 86 00          '..'
        STAA    opn_ch                   ;F462: 97 86          '..'
        JSR     opn_keyoff               ;F464: BD F5 D2       '...'
        INC     >opn_ch                  ;F467: 7C 00 86       '|..'
        JSR     opn_keyoff               ;F46A: BD F5 D2       '...'
        INC     >opn_ch                  ;F46D: 7C 00 86       '|..'
        JSR     opn_keyoff               ;F470: BD F5 D2       '...'
        LDAA    #$28                     ;F473: 86 28          '.('
        LDAB    #$27                     ;F475: C6 27          '.''
        JSR     opn_write                ;F477: BD F4 90       '...'   write timer A/B control and 3ch mode
        LDAA    #$0F                     ;F47A: 86 0F          '..'    probably all off 1111
        LDAB    #$0E                     ;F47C: C6 0E          '..'
        JSR     opn_write                ;F47E: BD F4 90       '...'   io a
        AIM     #$FB,M0008               ;F481: 71 FB 08       'q..'   disable TOI
        AIM     #$F7,M0003               ;F484: 71 F7 03       'q..'
        AIM     #$FE,M0003               ;F487: 71 FE 03       'q..'
        AIM     #$FB,M0003               ;F48A: 71 FB 03       'q..'
        JMP     mainloop                 ;F48D: 7E F0 5A       '~.Z'
opn_write PSHA                             ;F490: 36             '6'
        LDAA    #$80                     ;F491: 86 80          '..'
ZF493   BITA    opn_reg                  ;F493: B5 01 00       '...'
        BNE     ZF493                    ;F496: 26 FB          '&.'
        STAB    opn_reg                  ;F498: F7 01 00       '...'
ZF49B   BITA    opn_reg                  ;F49B: B5 01 00       '...'
        BNE     ZF49B                    ;F49E: 26 FB          '&.'
        TIM     #$80,M0007               ;F4A0: 7B 80 07       '{..'
        BEQ     ZF4AA                    ;F4A3: 27 05          ''.'    bra if ml301
        PULA                             ;F4A5: 32             '2'
        STAA    opn_data_ml304           ;F4A6: B7 01 40       '..@'
        RTS                              ;F4A9: 39             '9'
ZF4AA   PULA                             ;F4AA: 32             '2'
        STAA    card_d_data              ;F4AB: B7 01 01       '...'
        RTS                              ;F4AE: 39             '9'
opn_read LDAA    #$80                     ;F4AF: 86 80          '..'
ZF4B1   BITA    opn_reg                  ;F4B1: B5 01 00       '...'
        BNE     ZF4B1                    ;F4B4: 26 FB          '&.'
        STAB    opn_reg                  ;F4B6: F7 01 00       '...'
ZF4B9   BITA    opn_reg                  ;F4B9: B5 01 00       '...'
        BNE     ZF4B9                    ;F4BC: 26 FB          '&.'
        TIM     #$80,M0007               ;F4BE: 7B 80 07       '{..'
        BEQ     ZF4C7                    ;F4C1: 27 04          ''.'    bra if ml301
        LDAA    opn_data_ml304           ;F4C3: B6 01 40       '..@'
        RTS                              ;F4C6: 39             '9'
ZF4C7   LDAA    card_d_data              ;F4C7: B6 01 01       '...'
        RTS                              ;F4CA: 39             '9'
read_tune_data PSHX                             ;F4CB: 3C             '<'
        LDX     card_pointer             ;F4CC: DE A9          '..'
        LDAA    ,X                       ;F4CE: A6 00          '..'
        PULX                             ;F4D0: 38             '8'
        RTS                              ;F4D1: 39             '9'
ZF4D2   LDAB    opn_ch                   ;F4D2: D6 86          '..'
        ADDB    #$30                     ;F4D4: CB 30          '.0'
        CLRA                             ;F4D6: 4F             'O'
        STAA    patch_upload_tmp         ;F4D7: 97 92          '..'
        LDX     patch_loc_word           ;F4D9: DE B1          '..'
ZF4DB   STX     card_addr                ;F4DB: FF 01 05       '...'
        JSR     read_tune_data           ;F4DE: BD F4 CB       '...'
        JSR     opn_write                ;F4E1: BD F4 90       '...'   drt/mul
        INCB                             ;F4E4: 5C             '\'
        INCB                             ;F4E5: 5C             '\'
        INCB                             ;F4E6: 5C             '\'
        INCB                             ;F4E7: 5C             '\'
        INX                              ;F4E8: 08             '.'
        INC     >patch_upload_tmp        ;F4E9: 7C 00 92       '|..'
        LDAA    patch_upload_tmp         ;F4EC: 96 92          '..'
        CMPA    #$18                     ;F4EE: 81 18          '..'
        BNE     ZF4DB                    ;F4F0: 26 E9          '&.'
        LDAB    opn_ch                   ;F4F2: D6 86          '..'
        ADDB    #$B0                     ;F4F4: CB B0          '..'
        STX     card_addr                ;F4F6: FF 01 05       '...'
        JSR     read_tune_data           ;F4F9: BD F4 CB       '...'
        JSR     opn_write                ;F4FC: BD F4 90       '...'   write algo+fb
        LDX     patch_loc_word           ;F4FF: DE B1          '..'
        LDAB    #$04                     ;F501: C6 04          '..'
        ABX                              ;F503: 3A             ':'
        STX     card_addr                ;F504: FF 01 05       '...'   first tl in patch (patch loc + 4)
        JSR     read_tune_data           ;F507: BD F4 CB       '...'
        STAA    tl_op1                   ;F50A: 97 A2          '..'
        INX                              ;F50C: 08             '.'
        STX     card_addr                ;F50D: FF 01 05       '...'
        JSR     read_tune_data           ;F510: BD F4 CB       '...'
        STAA    tl_op3                   ;F513: 97 A4          '..'
        INX                              ;F515: 08             '.'
        STX     card_addr                ;F516: FF 01 05       '...'
        JSR     read_tune_data           ;F519: BD F4 CB       '...'
        STAA    tl_op2                   ;F51C: 97 A3          '..'
        INX                              ;F51E: 08             '.'
        STX     card_addr                ;F51F: FF 01 05       '...'
        JSR     read_tune_data           ;F522: BD F4 CB       '...'
        STAA    tl_op4                   ;F525: 97 A5          '..'
        LDX     patch_loc_word           ;F527: DE B1          '..'
        LDAB    #$18                     ;F529: C6 18          '..'
        ABX                              ;F52B: 3A             ':'
        STX     card_addr                ;F52C: FF 01 05       '...'   fb/algo (patch loc + 0x18)
        JSR     read_tune_data           ;F52F: BD F4 CB       '...'
        ANDA    #$07                     ;F532: 84 07          '..'
        LDX     #fb_algo_base            ;F534: CE 00 93       '...'
        JSR     add_opn_ch_x             ;F537: BD F7 1D       '...'
        STAA    ,X                       ;F53A: A7 00          '..'
        LDAA    tl_op1                   ;F53C: 96 A2          '..'
        LDX     #tl_op1_base             ;F53E: CE 00 96       '...'
        JSR     add_opn_ch_x             ;F541: BD F7 1D       '...'
        STAA    ,X                       ;F544: A7 00          '..'
        LDAA    tl_op2                   ;F546: 96 A3          '..'
        LDX     #tl_op2_base             ;F548: CE 00 99       '...'
        JSR     add_opn_ch_x             ;F54B: BD F7 1D       '...'
        STAA    ,X                       ;F54E: A7 00          '..'
        LDAA    tl_op3                   ;F550: 96 A4          '..'
        LDX     #tl_op3_base             ;F552: CE 00 9C       '...'
        JSR     add_opn_ch_x             ;F555: BD F7 1D       '...'
        STAA    ,X                       ;F558: A7 00          '..'
        LDAA    tl_op4                   ;F55A: 96 A5          '..'
        LDX     #tl_op4_base             ;F55C: CE 00 9F       '...'
        JSR     add_opn_ch_x             ;F55F: BD F7 1D       '...'
        STAA    ,X                       ;F562: A7 00          '..'
        RTS                              ;F564: 39             '9'
opn_write_4op_tl LDX     #fb_algo_base            ;F565: CE 00 93       '...'
        JSR     add_opn_ch_x             ;F568: BD F7 1D       '...'
        LDAA    ,X                       ;F56B: A6 00          '..'
        CMPA    #$07                     ;F56D: 81 07          '..'    all of these CMPAs are to write TL only for slot operators
        BEQ     ZF5B5                    ;F56F: 27 44          ''D'
        CMPA    #$06                     ;F571: 81 06          '..'
        BEQ     ZF5A2                    ;F573: 27 2D          ''-'
        CMPA    #$05                     ;F575: 81 05          '..'
        BEQ     ZF5A2                    ;F577: 27 29          '')'
        CMPA    #$04                     ;F579: 81 04          '..'
        BEQ     ZF58F                    ;F57B: 27 12          ''.'
ZF57D   LDX     #tl_op4_base             ;F57D: CE 00 9F       '...'
        JSR     add_opn_ch_x             ;F580: BD F7 1D       '...'
        LDAA    ,X                       ;F583: A6 00          '..'
        ADDA    opn_tl_modifier          ;F585: 9B A8          '..'
        LDAB    #$4C                     ;F587: C6 4C          '.L'
        ADDB    opn_ch                   ;F589: DB 86          '..'
        JSR     opn_write                ;F58B: BD F4 90       '...'
        RTS                              ;F58E: 39             '9'
ZF58F   LDX     #tl_op2_base             ;F58F: CE 00 99       '...'
        JSR     add_opn_ch_x             ;F592: BD F7 1D       '...'
        LDAA    ,X                       ;F595: A6 00          '..'
        ADDA    opn_tl_modifier          ;F597: 9B A8          '..'
        LDAB    #$48                     ;F599: C6 48          '.H'
        ADDB    opn_ch                   ;F59B: DB 86          '..'
        JSR     opn_write                ;F59D: BD F4 90       '...'
        BRA     ZF57D                    ;F5A0: 20 DB          ' .'
ZF5A2   LDX     #tl_op3_base             ;F5A2: CE 00 9C       '...'
        JSR     add_opn_ch_x             ;F5A5: BD F7 1D       '...'
        LDAA    ,X                       ;F5A8: A6 00          '..'
        ADDA    opn_tl_modifier          ;F5AA: 9B A8          '..'
        LDAB    #$43                     ;F5AC: C6 43          '.C'    BUG!!! should be $44
        ADDB    opn_ch                   ;F5AE: DB 86          '..'
        JSR     opn_write                ;F5B0: BD F4 90       '...'
        BRA     ZF58F                    ;F5B3: 20 DA          ' .'
ZF5B5   LDX     #tl_op1_base             ;F5B5: CE 00 96       '...'
        JSR     add_opn_ch_x             ;F5B8: BD F7 1D       '...'
        LDAA    ,X                       ;F5BB: A6 00          '..'
        ADDA    opn_tl_modifier          ;F5BD: 9B A8          '..'
        LDAB    #$40                     ;F5BF: C6 40          '.@'
        ADDB    opn_ch                   ;F5C1: DB 86          '..'
        JSR     opn_write                ;F5C3: BD F4 90       '...'
        BRA     ZF5A2                    ;F5C6: 20 DA          ' .'
opn_keyon LDAA    opn_ch                   ;F5C8: 96 86          '..'
        ORAA    #$F0                     ;F5CA: 8A F0          '..'
        LDAB    #$28                     ;F5CC: C6 28          '.('
        JSR     opn_write                ;F5CE: BD F4 90       '...'
        RTS                              ;F5D1: 39             '9'
opn_keyoff LDAA    opn_ch                   ;F5D2: 96 86          '..'
        ANDA    #$0F                     ;F5D4: 84 0F          '..'
        LDAB    #$28                     ;F5D6: C6 28          '.('
        JSR     opn_write                ;F5D8: BD F4 90       '...'
        RTS                              ;F5DB: 39             '9'
opn_write_freq LDAB    cur_note_freq            ;F5DC: D6 A6          '..'
        CLRA                             ;F5DE: 4F             'O'
        ASLD                             ;F5DF: 05             '.'     shl a <- b
        ASLD                             ;F5E0: 05             '.'
        ASLD                             ;F5E1: 05             '.'
        ASLD                             ;F5E2: 05             '.'
        LSRB                             ;F5E3: 54             'T'
        LSRB                             ;F5E4: 54             'T'
        LSRB                             ;F5E5: 54             'T'
        STAB    unused1                  ;F5E6: D7 A7          '..'
        LDX     #scale_lut               ;F5E8: CE F0 00       '...'
        ABX                              ;F5EB: 3A             ':'     x+=b
        LDAB    ,X                       ;F5EC: E6 00          '..'
        ASLA                             ;F5EE: 48             'H'
        ASLA                             ;F5EF: 48             'H'
        ASLA                             ;F5F0: 48             'H'
        ABA                              ;F5F1: 1B             '.'     a+=b
        LDAB    #$A4                     ;F5F2: C6 A4          '..'
        ADDB    opn_ch                   ;F5F4: DB 86          '..'
        JSR     opn_write                ;F5F6: BD F4 90       '...'   freq hi
        INX                              ;F5F9: 08             '.'
        LDAA    ,X                       ;F5FA: A6 00          '..'
        LDAB    #$A0                     ;F5FC: C6 A0          '..'
        ADDB    opn_ch                   ;F5FE: DB 86          '..'
        JSR     opn_write                ;F600: BD F4 90       '...'   freq lo
        RTS                              ;F603: 39             '9'
opn_timerb_setup LDAA    #$FF                     ;F604: 86 FF          '..'
        LDAB    opn_timer_b              ;F606: D6 8A          '..'
        SBA                              ;F608: 10             '.'     a = ff - timerb
        LSRA                             ;F609: 44             'D'
        LSRA                             ;F60A: 44             'D'
        LSRA                             ;F60B: 44             'D'     a /= 8
        STAA    M008B                    ;F60C: 97 8B          '..'
        LDAB    #$0F                     ;F60E: C6 0F          '..'
        JSR     opn_read                 ;F610: BD F4 AF       '...'   a = io port b
        LSRA                             ;F613: 44             'D'     a >>= 1
        ANDA    #$0F                     ;F614: 84 0F          '..'    a &= 0xf
        CMPA    #$0A                     ;F616: 81 0A          '..'
        BGE     ZF647                    ;F618: 2C 2D          ',-'    bra rts
        LDAB    opn_timer_b              ;F61A: D6 8A          '..'
        CMPA    #$05                     ;F61C: 81 05          '..'
        BEQ     ZF640                    ;F61E: 27 20          '' '    bra use normal value
        BMI     ZF631                    ;F620: 2B 0F          '+.'
ZF622   CLC                              ;F622: 0C             '.'
        ADDB    M008B                    ;F623: DB 8B          '..'
        BCC     ZF629                    ;F625: 24 02          '$.'
        LDAB    #$FF                     ;F627: C6 FF          '..'
ZF629   DECA                             ;F629: 4A             'J'
        CMPA    #$05                     ;F62A: 81 05          '..'
        BNE     ZF622                    ;F62C: 26 F4          '&.'
        TBA                              ;F62E: 17             '.'
        BRA     ZF642                    ;F62F: 20 11          ' .'    bra write A
ZF631   CLC                              ;F631: 0C             '.'
        SBCB    M008B                    ;F632: D2 8B          '..'
        BCC     ZF638                    ;F634: 24 02          '$.'
        LDAB    #$00                     ;F636: C6 00          '..'
ZF638   INCA                             ;F638: 4C             'L'
        CMPA    #$05                     ;F639: 81 05          '..'
        BNE     ZF631                    ;F63B: 26 F4          '&.'
        TBA                              ;F63D: 17             '.'
        BRA     ZF642                    ;F63E: 20 02          ' .'    bra write A
ZF640   LDAA    opn_timer_b              ;F640: 96 8A          '..'    use normal value
ZF642   LDAB    #$26                     ;F642: C6 26          '.&'    write A
        JSR     opn_write                ;F644: BD F4 90       '...'   tiemr b
ZF647   RTS                              ;F647: 39             '9'
ml304_setup_next_note_trk1 LDX     track1_loc_word          ;F648: DE 80          '..'
        STX     card_addr                ;F64A: FF 01 05       '...'
        JSR     read_tune_data           ;F64D: BD F4 CB       '...'
        CMPA    #$FE                     ;F650: 81 FE          '..'
        BEQ     ZF686                    ;F652: 27 32          ''2'
        CMPA    #$FF                     ;F654: 81 FF          '..'
        BEQ     ZF68B                    ;F656: 27 33          ''3'
        STAA    cur_note_freq            ;F658: 97 A6          '..'
        INX                              ;F65A: 08             '.'
        STX     card_addr                ;F65B: FF 01 05       '...'
        JSR     read_tune_data           ;F65E: BD F4 CB       '...'
        STAA    track1_note_len          ;F661: 97 8C          '..'
        INX                              ;F663: 08             '.'
        STX     card_addr                ;F664: FF 01 05       '...'
        JSR     read_tune_data           ;F667: BD F4 CB       '...'
        STAA    track1_kon_len           ;F66A: 97 8F          '..'
        INX                              ;F66C: 08             '.'
        STX     card_addr                ;F66D: FF 01 05       '...'
        JSR     read_tune_data           ;F670: BD F4 CB       '...'
        STAA    opn_tl_modifier          ;F673: 97 A8          '..'
        INX                              ;F675: 08             '.'
        STX     track1_loc_word          ;F676: DF 80          '..'
        LDAA    track1_kon_len           ;F678: 96 8F          '..'
        BEQ     ZF685                    ;F67A: 27 09          ''.'
        JSR     opn_write_4op_tl         ;F67C: BD F5 65       '..e'
        JSR     opn_write_freq           ;F67F: BD F5 DC       '...'
        JSR     opn_keyon                ;F682: BD F5 C8       '...'
ZF685   RTS                              ;F685: 39             '9'
ZF686   LDAA    #$FF                     ;F686: 86 FF          '..'
        STAA    track1_is_finished       ;F688: 97 87          '..'
        RTS                              ;F68A: 39             '9'
ZF68B   OIM     #$01,tune_found_ff_flag  ;F68B: 72 01 B9       'r..'
        RTS                              ;F68E: 39             '9'
ml304_setup_next_note_trk2 LDX     track2_loc_word          ;F68F: DE 82          '..'
        STX     card_addr                ;F691: FF 01 05       '...'
        JSR     read_tune_data           ;F694: BD F4 CB       '...'
        CMPA    #$FE                     ;F697: 81 FE          '..'
        BEQ     ZF6CD                    ;F699: 27 32          ''2'
        STAA    cur_note_freq            ;F69B: 97 A6          '..'
        CMPA    #$FF                     ;F69D: 81 FF          '..'
        BEQ     load_ch_patch            ;F69F: 27 31          ''1'
        INX                              ;F6A1: 08             '.'
        STX     card_addr                ;F6A2: FF 01 05       '...'
        JSR     read_tune_data           ;F6A5: BD F4 CB       '...'
        STAA    track2_note_len          ;F6A8: 97 8D          '..'
        INX                              ;F6AA: 08             '.'
        STX     card_addr                ;F6AB: FF 01 05       '...'
        JSR     read_tune_data           ;F6AE: BD F4 CB       '...'
        STAA    track2_kon_len           ;F6B1: 97 90          '..'
        INX                              ;F6B3: 08             '.'
        STX     card_addr                ;F6B4: FF 01 05       '...'
        JSR     read_tune_data           ;F6B7: BD F4 CB       '...'
        STAA    opn_tl_modifier          ;F6BA: 97 A8          '..'
        INX                              ;F6BC: 08             '.'
        STX     track2_loc_word          ;F6BD: DF 82          '..'
        LDAA    track2_kon_len           ;F6BF: 96 90          '..'
        BEQ     ZF6CC                    ;F6C1: 27 09          ''.'
        JSR     opn_write_4op_tl         ;F6C3: BD F5 65       '..e'
        JSR     opn_write_freq           ;F6C6: BD F5 DC       '...'
        JSR     opn_keyon                ;F6C9: BD F5 C8       '...'
ZF6CC   RTS                              ;F6CC: 39             '9'
ZF6CD   LDAA    #$FF                     ;F6CD: 86 FF          '..'
        STAA    track2_is_finished       ;F6CF: 97 88          '..'
        RTS                              ;F6D1: 39             '9'
load_ch_patch OIM     #$01,tune_found_ff_flag  ;F6D2: 72 01 B9       'r..'
        RTS                              ;F6D5: 39             '9'
ml304_setup_next_note_trk3 LDX     track3_loc_word          ;F6D6: DE 84          '..'
        STX     card_addr                ;F6D8: FF 01 05       '...'
        JSR     read_tune_data           ;F6DB: BD F4 CB       '...'
        CMPA    #$FE                     ;F6DE: 81 FE          '..'
        BEQ     ZF714                    ;F6E0: 27 32          ''2'
        CMPA    #$FF                     ;F6E2: 81 FF          '..'
        BEQ     ZF719                    ;F6E4: 27 33          ''3'
        STAA    cur_note_freq            ;F6E6: 97 A6          '..'
        INX                              ;F6E8: 08             '.'
        STX     card_addr                ;F6E9: FF 01 05       '...'
        JSR     read_tune_data           ;F6EC: BD F4 CB       '...'
        STAA    track3_note_len          ;F6EF: 97 8E          '..'
        INX                              ;F6F1: 08             '.'
        STX     card_addr                ;F6F2: FF 01 05       '...'
        JSR     read_tune_data           ;F6F5: BD F4 CB       '...'
        STAA    track3_kon_len           ;F6F8: 97 91          '..'
        INX                              ;F6FA: 08             '.'
        STX     card_addr                ;F6FB: FF 01 05       '...'
        JSR     read_tune_data           ;F6FE: BD F4 CB       '...'
        STAA    opn_tl_modifier          ;F701: 97 A8          '..'
        INX                              ;F703: 08             '.'
        STX     track3_loc_word          ;F704: DF 84          '..'
        LDAA    track3_kon_len           ;F706: 96 91          '..'
        BEQ     ZF713                    ;F708: 27 09          ''.'
        JSR     opn_write_4op_tl         ;F70A: BD F5 65       '..e'
        JSR     opn_write_freq           ;F70D: BD F5 DC       '...'
        JSR     opn_keyon                ;F710: BD F5 C8       '...'
ZF713   RTS                              ;F713: 39             '9'
ZF714   LDAA    #$FF                     ;F714: 86 FF          '..'
        STAA    track3_is_finished       ;F716: 97 89          '..'
        RTS                              ;F718: 39             '9'
ZF719   OIM     #$01,tune_found_ff_flag  ;F719: 72 01 B9       'r..'
        RTS                              ;F71C: 39             '9'
add_opn_ch_x LDAB    opn_ch                   ;F71D: D6 86          '..'
        CMPB    #$00                     ;F71F: C1 00          '..'
        BEQ     ZF729                    ;F721: 27 06          ''.'
        INX                              ;F723: 08             '.'
        CMPB    #$01                     ;F724: C1 01          '..'
        BEQ     ZF729                    ;F726: 27 01          ''.'
        INX                              ;F728: 08             '.'
ZF729   RTS                              ;F729: 39             '9'
spin_delay_100ms PSHA                             ;F72A: 36             '6'
        CLRB                             ;F72B: 5F             '_'
ZF72C   CLRA                             ;F72C: 4F             'O'
ZF72D   INCA                             ;F72D: 4C             'L'
        BNE     ZF72D                    ;F72E: 26 FD          '&.'
        INCB                             ;F730: 5C             '\'
        CMPB    #$64                     ;F731: C1 64          '.d'
        BNE     ZF72C                    ;F733: 26 F7          '&.'
        PULA                             ;F735: 32             '2'
        RTS                              ;F736: 39             '9'
hdlr_IRQ AIM     #$FE,int_flag            ;F737: 71 FE B3       'q..'
        LDAA    #$2A                     ;F73A: 86 2A          '.*'
        LDAB    #$27                     ;F73C: C6 27          '.''
        JSR     opn_write                ;F73E: BD F4 90       '...'   clear timer b flag
        TIM     #$80,M0007               ;F741: 7B 80 07       '{..'
        BEQ     ZF775                    ;F744: 27 2F          ''/'    bra if ml301
        JSR     opn_timerb_setup         ;F746: BD F6 04       '...'
ZF749   LDAA    track1_kon_len           ;F749: 96 8F          '..'
        BEQ     ZF750                    ;F74B: 27 03          ''.'
        DECA                             ;F74D: 4A             'J'
        STAA    track1_kon_len           ;F74E: 97 8F          '..'
ZF750   LDAA    track1_note_len          ;F750: 96 8C          '..'
        BEQ     ZF757                    ;F752: 27 03          ''.'
        DECA                             ;F754: 4A             'J'
        STAA    track1_note_len          ;F755: 97 8C          '..'
ZF757   LDAA    track2_kon_len           ;F757: 96 90          '..'
        BEQ     ZF75E                    ;F759: 27 03          ''.'
        DECA                             ;F75B: 4A             'J'
        STAA    track2_kon_len           ;F75C: 97 90          '..'
ZF75E   LDAA    track2_note_len          ;F75E: 96 8D          '..'
        BEQ     ZF765                    ;F760: 27 03          ''.'
        DECA                             ;F762: 4A             'J'
        STAA    track2_note_len          ;F763: 97 8D          '..'
ZF765   LDAA    track3_kon_len           ;F765: 96 91          '..'
        BEQ     ZF76C                    ;F767: 27 03          ''.'
        DECA                             ;F769: 4A             'J'
        STAA    track3_kon_len           ;F76A: 97 91          '..'
ZF76C   LDAA    track3_note_len          ;F76C: 96 8E          '..'
        BEQ     ZF773                    ;F76E: 27 03          ''.'
        DECA                             ;F770: 4A             'J'
        STAA    track3_note_len          ;F771: 97 8E          '..'
ZF773   CLI                              ;F773: 0E             '.'
        RTI                              ;F774: 3B             ';'
ZF775   JSR     ZFAE5                    ;F775: BD FA E5       '...'
        JMP     ZF749                    ;F778: 7E F7 49       '~.I'
hdlr_SWI3 TIM     #$80,M0007               ;F77B: 7B 80 07       '{..'
        BNE     ZF783                    ;F77E: 26 03          '&.'    bra if ml304
        JMP     ml301_swi_isr            ;F780: 7E FB BB       '~..'
ZF783   PSHA                             ;F783: 36             '6'
        PSHB                             ;F784: 37             '7'
        PSHX                             ;F785: 3C             '<'
        LDAA    M0002                    ;F786: 96 02          '..'
        COMA                             ;F788: 43             'C'
        STAA    port1_isr_tmp            ;F789: 97 B7          '..'
        BEQ     isr_swi3_nothing_pressed ;F78B: 27 3C          ''<'    bra if nothing pressed
        TIM     #$01,nothing_pressed_in_isr ;F78D: 7B 01 B8       '{..'
        BEQ     isr_swi3_exit            ;F790: 27 2E          ''.'
        EORA    pressed_switch_bitfield  ;F792: 98 B6          '..'
        ANDA    port1_isr_tmp            ;F794: 94 B7          '..'
        STAA    port1_isr_tmp            ;F796: 97 B7          '..'
        TIM     #$80,port1_isr_tmp       ;F798: 7B 80 B7       '{..'
        BNE     ZF7DA                    ;F79B: 26 3D          '&='
        TIM     #$01,port1_isr_tmp       ;F79D: 7B 01 B7       '{..'
        BNE     ZF7CF                    ;F7A0: 26 2D          '&-'
        TIM     #$40,port1_isr_tmp       ;F7A2: 7B 40 B7       '{@.'
        BNE     ZF7F0                    ;F7A5: 26 49          '&I'
        TIM     #$02,port1_isr_tmp       ;F7A7: 7B 02 B7       '{..'
        BNE     ZF7E5                    ;F7AA: 26 39          '&9'
        TIM     #$20,port1_isr_tmp       ;F7AC: 7B 20 B7       '{ .'
        BNE     ZF806                    ;F7AF: 26 55          '&U'
        TIM     #$04,port1_isr_tmp       ;F7B1: 7B 04 B7       '{..'
        BNE     ZF7FB                    ;F7B4: 26 45          '&E'
        TIM     #$10,port1_isr_tmp       ;F7B6: 7B 10 B7       '{..'
        BNE     ZF81C                    ;F7B9: 26 61          '&a'
        TIM     #$08,port1_isr_tmp       ;F7BB: 7B 08 B7       '{..'
        BNE     ZF811                    ;F7BE: 26 51          '&Q'
isr_swi3_exit LDAA    M0008                    ;F7C0: 96 08          '..'    clear TOF
        LDAA    M0009                    ;F7C2: 96 09          '..'    clear TOF
        PULX                             ;F7C4: 38             '8'
        PULB                             ;F7C5: 33             '3'
        PULA                             ;F7C6: 32             '2'
        CLI                              ;F7C7: 0E             '.'
        RTI                              ;F7C8: 3B             ';'
isr_swi3_nothing_pressed OIM     #$01,nothing_pressed_in_isr ;F7C9: 72 01 B8       'r..'
        JMP     isr_swi3_exit            ;F7CC: 7E F7 C0       '~..'
ZF7CF   TIM     #$01,currently_playing_bitfield ;F7CF: 7B 01 B5       '{..'
        BNE     ZF827                    ;F7D2: 26 53          '&S'
        OIM     #$01,currently_playing_bitfield ;F7D4: 72 01 B5       'r..'
        JMP     isr_swi3_exit            ;F7D7: 7E F7 C0       '~..'
ZF7DA   TIM     #$80,currently_playing_bitfield ;F7DA: 7B 80 B5       '{..'
        BNE     ZF827                    ;F7DD: 26 48          '&H'
        OIM     #$80,currently_playing_bitfield ;F7DF: 72 80 B5       'r..'
        JMP     isr_swi3_exit            ;F7E2: 7E F7 C0       '~..'
ZF7E5   TIM     #$02,currently_playing_bitfield ;F7E5: 7B 02 B5       '{..'
        BNE     ZF827                    ;F7E8: 26 3D          '&='
        OIM     #$02,currently_playing_bitfield ;F7EA: 72 02 B5       'r..'
        JMP     isr_swi3_exit            ;F7ED: 7E F7 C0       '~..'
ZF7F0   TIM     #$40,currently_playing_bitfield ;F7F0: 7B 40 B5       '{@.'
        BNE     ZF827                    ;F7F3: 26 32          '&2'
        OIM     #$40,currently_playing_bitfield ;F7F5: 72 40 B5       'r@.'
        JMP     isr_swi3_exit            ;F7F8: 7E F7 C0       '~..'
ZF7FB   TIM     #$04,currently_playing_bitfield ;F7FB: 7B 04 B5       '{..'
        BNE     ZF827                    ;F7FE: 26 27          '&''
        OIM     #$04,currently_playing_bitfield ;F800: 72 04 B5       'r..'
        JMP     isr_swi3_exit            ;F803: 7E F7 C0       '~..'
ZF806   TIM     #$20,currently_playing_bitfield ;F806: 7B 20 B5       '{ .'
        BNE     ZF827                    ;F809: 26 1C          '&.'
        OIM     #$20,currently_playing_bitfield ;F80B: 72 20 B5       'r .'
        JMP     isr_swi3_exit            ;F80E: 7E F7 C0       '~..'
ZF811   TIM     #$08,currently_playing_bitfield ;F811: 7B 08 B5       '{..'
        BNE     ZF827                    ;F814: 26 11          '&.'
        OIM     #$08,currently_playing_bitfield ;F816: 72 08 B5       'r..'
        JMP     isr_swi3_exit            ;F819: 7E F7 C0       '~..'
ZF81C   TIM     #$10,currently_playing_bitfield ;F81C: 7B 10 B5       '{..'
        BNE     ZF827                    ;F81F: 26 06          '&.'
        OIM     #$10,currently_playing_bitfield ;F821: 72 10 B5       'r..'
        JMP     isr_swi3_exit            ;F824: 7E F7 C0       '~..'
ZF827   OIM     #$01,already_playing     ;F827: 72 01 B4       'r..'   all bra here if selected card is already playing?
        AIM     #$FE,nothing_pressed_in_isr ;F82A: 71 FE B8       'q..'
        JMP     isr_swi3_exit            ;F82D: 7E F7 C0       '~..'
ml301_mode CLRA                             ;F830: 4F             'O'
        STAA    M0002                    ;F831: 97 02          '..'
        STAA    M0003                    ;F833: 97 03          '..'
        LDAA    #$70                     ;F835: 86 70          '.p'
        STAA    M0000                    ;F837: 97 00          '..'
        LDAA    #$08                     ;F839: 86 08          '..'
        STAA    M0001                    ;F83B: 97 01          '..'
        LDAA    #$7F                     ;F83D: 86 7F          '..'
        STAA    M0005                    ;F83F: 97 05          '..'
        LDS     #M00FF                   ;F841: 8E 00 FF       '...'
        LDAB    #$2D                     ;F844: C6 2D          '.-'
        JSR     opn_write                ;F846: BD F4 90       '...'   prescaler
        LDAB    #$07                     ;F849: C6 07          '..'
        LDAA    #$7F                     ;F84B: 86 7F          '..'
        JSR     opn_write                ;F84D: BD F4 90       '...'   ssg enable
        LDAA    #$03                     ;F850: 86 03          '..'
        LDAB    #$0E                     ;F852: C6 0E          '..'
        JSR     opn_write                ;F854: BD F4 90       '...'   io a
        CLRA                             ;F857: 4F             'O'
        STAA    opn_ch                   ;F858: 97 86          '..'
        JSR     opn_keyoff               ;F85A: BD F5 D2       '...'
        INC     >opn_ch                  ;F85D: 7C 00 86       '|..'
        JSR     opn_keyoff               ;F860: BD F5 D2       '...'
        INC     >opn_ch                  ;F863: 7C 00 86       '|..'
        JSR     opn_keyoff               ;F866: BD F5 D2       '...'
ZF869   CLRA                             ;F869: 4F             'O'
        STAA    track1_note_len          ;F86A: 97 8C          '..'
        STAA    track2_note_len          ;F86C: 97 8D          '..'
        STAA    track3_note_len          ;F86E: 97 8E          '..'
        STAA    track1_kon_len           ;F870: 97 8F          '..'
        STAA    track2_kon_len           ;F872: 97 90          '..'
        STAA    track3_kon_len           ;F874: 97 91          '..'
        STAA    unk_M00BE                ;F876: 97 BE          '..'
        STAA    M00C1                    ;F878: 97 C1          '..'
        STAA    M00BF                    ;F87A: 97 BF          '..'
        STAA    M00C0                    ;F87C: 97 C0          '..'
        STAA    already_playing          ;F87E: 97 B4          '..'
        STAA    int_flag                 ;F880: 97 B3          '..'
        TIM     #$02,M0002               ;F882: 7B 02 02       '{..'
        BNE     ZF88A                    ;F885: 26 03          '&.'
        JMP     ZF92F                    ;F887: 7E F9 2F       '~./'
ZF88A   TIM     #$08,M0002               ;F88A: 7B 08 02       '{..'
        BNE     ZF892                    ;F88D: 26 03          '&.'
        JMP     ZF962                    ;F88F: 7E F9 62       '~.b'
ZF892   TIM     #$80,M0002               ;F892: 7B 80 02       '{..'
        BEQ     ZF89A                    ;F895: 27 03          ''.'
        JMP     ZF96C                    ;F897: 7E F9 6C       '~.l'
ZF89A   TIM     #$01,M0002               ;F89A: 7B 01 02       '{..'
        BEQ     ZF8A2                    ;F89D: 27 03          ''.'
        JMP     ZF869                    ;F89F: 7E F8 69       '~.i'
ZF8A2   JSR     spin_delay_100ms         ;F8A2: BD F7 2A       '..*'
        TIM     #$01,M0002               ;F8A5: 7B 01 02       '{..'
        BNE     ZF869                    ;F8A8: 26 BF          '&.'
        INC     >unk_M00BE               ;F8AA: 7C 00 BE       '|..'
        OIM     #$10,M0002               ;F8AD: 72 10 02       'r..'
        LDAA    #$01                     ;F8B0: 86 01          '..'
        LDAB    #$0E                     ;F8B2: C6 0E          '..'
        JSR     opn_write                ;F8B4: BD F4 90       '...'   io a
        LDX     ml301_builtin_tunes      ;F8B7: FE FD 00       '...'
        STX     unk_M00BC                ;F8BA: DF BC          '..'
ZF8BC   LDX     #MFFFF                   ;F8BC: CE FF FF       '...'
        STX     M0009                    ;F8BF: DF 09          '..'
        OIM     #$04,M0008               ;F8C1: 72 04 08       'r..'   enable TOI
        CLI                              ;F8C4: 0E             '.'
        LDX     unk_M00BC                ;F8C5: DE BC          '..'
        LDD     $06,X                    ;F8C7: EC 06          '..'
        BEQ     ZF91A                    ;F8C9: 27 4F          ''O'
        STD     track1_loc_word          ;F8CB: DD 80          '..'
        LDAA    #$00                     ;F8CD: 86 00          '..'
        STAA    opn_ch                   ;F8CF: 97 86          '..'
        LDX     ,X                       ;F8D1: EE 00          '..'
        JSR     ZFA79                    ;F8D3: BD FA 79       '..y'
        CLRA                             ;F8D6: 4F             'O'
        STAA    track1_is_finished       ;F8D7: 97 87          '..'
ZF8D9   LDX     unk_M00BC                ;F8D9: DE BC          '..'
        LDD     $08,X                    ;F8DB: EC 08          '..'
        BEQ     ZF921                    ;F8DD: 27 42          ''B'
        STD     track2_loc_word          ;F8DF: DD 82          '..'
        INX                              ;F8E1: 08             '.'
        INX                              ;F8E2: 08             '.'
        LDAA    #$01                     ;F8E3: 86 01          '..'
        STAA    opn_ch                   ;F8E5: 97 86          '..'
        LDX     ,X                       ;F8E7: EE 00          '..'
        JSR     ZFA79                    ;F8E9: BD FA 79       '..y'
        CLRA                             ;F8EC: 4F             'O'
        STAA    track2_is_finished       ;F8ED: 97 88          '..'
ZF8EF   LDX     unk_M00BC                ;F8EF: DE BC          '..'
        LDD     $0A,X                    ;F8F1: EC 0A          '..'
        BEQ     ZF928                    ;F8F3: 27 33          ''3'
        STD     track3_loc_word          ;F8F5: DD 84          '..'
        INX                              ;F8F7: 08             '.'
        INX                              ;F8F8: 08             '.'
        INX                              ;F8F9: 08             '.'
        INX                              ;F8FA: 08             '.'
        LDAA    #$02                     ;F8FB: 86 02          '..'
        STAA    opn_ch                   ;F8FD: 97 86          '..'
        LDX     ,X                       ;F8FF: EE 00          '..'
        JSR     ZFA79                    ;F901: BD FA 79       '..y'
        CLRA                             ;F904: 4F             'O'
        STAA    track3_is_finished       ;F905: 97 89          '..'
ZF907   LDX     unk_M00BC                ;F907: DE BC          '..'
        LDAA    $0D,X                    ;F909: A6 0D          '..'
        STAA    opn_timer_b              ;F90B: 97 8A          '..'
        JSR     ZFAE5                    ;F90D: BD FA E5       '...'
        LDAA    #$2A                     ;F910: 86 2A          '.*'
        LDAB    #$27                     ;F912: C6 27          '.''
        JSR     opn_write                ;F914: BD F4 90       '...'
        JMP     ZF98D                    ;F917: 7E F9 8D       '~..'
ZF91A   LDAA    #$FF                     ;F91A: 86 FF          '..'
        STAA    track1_is_finished       ;F91C: 97 87          '..'
        JMP     ZF8D9                    ;F91E: 7E F8 D9       '~..'
ZF921   LDAA    #$FF                     ;F921: 86 FF          '..'
        STAA    track2_is_finished       ;F923: 97 88          '..'
        JMP     ZF8EF                    ;F925: 7E F8 EF       '~..'
ZF928   LDAA    #$FF                     ;F928: 86 FF          '..'
        STAA    track3_is_finished       ;F92A: 97 89          '..'
        JMP     ZF907                    ;F92C: 7E F9 07       '~..'
ZF92F   JSR     spin_delay_100ms         ;F92F: BD F7 2A       '..*'
        TIM     #$02,M0002               ;F932: 7B 02 02       '{..'
        BNE     ZF95C                    ;F935: 26 25          '&%'
ZF937   AIM     #$EF,M0002               ;F937: 71 EF 02       'q..'
        OIM     #$08,M0003               ;F93A: 72 08 03       'r..'
        LDAA    #$02                     ;F93D: 86 02          '..'
        LDAB    #$0E                     ;F93F: C6 0E          '..'
        JSR     opn_write                ;F941: BD F4 90       '...'   io a
        INC     >M00C1                   ;F944: 7C 00 C1       '|..'
        LDAB    #$0F                     ;F947: C6 0F          '..'    io b
        JSR     opn_read                 ;F949: BD F4 AF       '...'
        BITA    #$20                     ;F94C: 85 20          '. '
        BEQ     ZF982                    ;F94E: 27 32          ''2'
        BITA    #$40                     ;F950: 85 40          '.@'
        BEQ     ZF977                    ;F952: 27 23          ''#'
ZF954   LDX     MFD02                    ;F954: FE FD 02       '...'
        STX     unk_M00BC                ;F957: DF BC          '..'
        JMP     ZF8BC                    ;F959: 7E F8 BC       '~..'
ZF95C   AIM     #$F7,M0003               ;F95C: 71 F7 03       'q..'
        JMP     ZF869                    ;F95F: 7E F8 69       '~.i'
ZF962   JSR     spin_delay_100ms         ;F962: BD F7 2A       '..*'
        TIM     #$08,M0002               ;F965: 7B 08 02       '{..'
        BNE     ZF95C                    ;F968: 26 F2          '&.'
        BRA     ZF937                    ;F96A: 20 CB          ' .'
ZF96C   JSR     spin_delay_100ms         ;F96C: BD F7 2A       '..*'
        TIM     #$80,M0002               ;F96F: 7B 80 02       '{..'
        BEQ     ZF95C                    ;F972: 27 E8          ''.'
        JMP     ZF937                    ;F974: 7E F9 37       '~.7'
ZF977   LDX     #M0014                   ;F977: CE 00 14       '...'   2 sec delay
ZF97A   JSR     spin_delay_100ms         ;F97A: BD F7 2A       '..*'
        DEX                              ;F97D: 09             '.'
        BNE     ZF97A                    ;F97E: 26 FA          '&.'
        BRA     ZF954                    ;F980: 20 D2          ' .'
ZF982   LDX     #M0028                   ;F982: CE 00 28       '..('   4 sec delay
ZF985   JSR     spin_delay_100ms         ;F985: BD F7 2A       '..*'
        DEX                              ;F988: 09             '.'
        BNE     ZF985                    ;F989: 26 FA          '&.'
        BRA     ZF954                    ;F98B: 20 C7          ' .'
ZF98D   OIM     #$01,int_flag            ;F98D: 72 01 B3       'r..'
        WAI                              ;F990: 3E             '>'
        TIM     #$01,int_flag            ;F991: 7B 01 B3       '{..'
        BNE     ZF98D                    ;F994: 26 F7          '&.'
        LDAA    already_playing          ;F996: 96 B4          '..'
        BEQ     ZF99D                    ;F998: 27 03          ''.'
        JMP     ZFA30                    ;F99A: 7E FA 30       '~.0'
ZF99D   LDAA    #$00                     ;F99D: 86 00          '..'
        STAA    opn_ch                   ;F99F: 97 86          '..'
        LDAA    track1_note_len          ;F9A1: 96 8C          '..'
        BNE     ZF9AC                    ;F9A3: 26 07          '&.'
        LDAA    track1_is_finished       ;F9A5: 96 87          '..'
        BNE     ZF9B3                    ;F9A7: 26 0A          '&.'
        JSR     ml301_setup_next_note_trk1 ;F9A9: BD FB 2E       '...'
ZF9AC   LDAA    track1_kon_len           ;F9AC: 96 8F          '..'
        BNE     ZF9B3                    ;F9AE: 26 03          '&.'
        JSR     opn_keyoff               ;F9B0: BD F5 D2       '...'
ZF9B3   LDAA    #$01                     ;F9B3: 86 01          '..'
        STAA    opn_ch                   ;F9B5: 97 86          '..'
        LDAA    track2_note_len          ;F9B7: 96 8D          '..'
        BNE     ZF9C2                    ;F9B9: 26 07          '&.'
        LDAA    track2_is_finished       ;F9BB: 96 88          '..'
        BNE     ZF9C9                    ;F9BD: 26 0A          '&.'
        JSR     ml301_setup_next_note_trk1 ;F9BF: BD FB 5D       '..]'
ZF9C2   LDAA    track2_kon_len           ;F9C2: 96 90          '..'
        BNE     ZF9C9                    ;F9C4: 26 03          '&.'
        JSR     opn_keyoff               ;F9C6: BD F5 D2       '...'
ZF9C9   LDAA    #$02                     ;F9C9: 86 02          '..'
        STAA    opn_ch                   ;F9CB: 97 86          '..'
        LDAA    track3_note_len          ;F9CD: 96 8E          '..'
        BNE     ZF9D8                    ;F9CF: 26 07          '&.'
        LDAA    track3_is_finished       ;F9D1: 96 89          '..'
        BNE     ZF9DF                    ;F9D3: 26 0A          '&.'
        JSR     ml301_setup_next_note_trk1 ;F9D5: BD FB 8C       '...'
ZF9D8   LDAA    track3_kon_len           ;F9D8: 96 91          '..'
        BNE     ZF9DF                    ;F9DA: 26 03          '&.'
        JSR     opn_keyoff               ;F9DC: BD F5 D2       '...'
ZF9DF   LDAA    track1_is_finished       ;F9DF: 96 87          '..'
        BEQ     ZF98D                    ;F9E1: 27 AA          ''.'
        LDAA    track2_is_finished       ;F9E3: 96 88          '..'
        BEQ     ZF98D                    ;F9E5: 27 A6          ''.'
        LDAA    track3_is_finished       ;F9E7: 96 89          '..'
        BEQ     ZF98D                    ;F9E9: 27 A2          ''.'
        LDAA    #$28                     ;F9EB: 86 28          '.('
        LDAB    #$27                     ;F9ED: C6 27          '.''
        JSR     opn_write                ;F9EF: BD F4 90       '...'   timer ab ctl 3ch mode
        LDAA    unk_M00BE                ;F9F2: 96 BE          '..'
        BNE     ZFA1C                    ;F9F4: 26 26          '&&'
        LDX     #M0064                   ;F9F6: CE 00 64       '..d'
ZF9F9   JSR     spin_delay_100ms         ;F9F9: BD F7 2A       '..*'
        DEX                              ;F9FC: 09             '.'
        BNE     ZF9F9                    ;F9FD: 26 FA          '&.'
ZF9FF   TIM     #$02,M0002               ;F9FF: 7B 02 02       '{..'
        BEQ     ZFA0C                    ;FA02: 27 08          ''.'
        TIM     #$08,M0002               ;FA04: 7B 08 02       '{..'
        BEQ     ZFA0C                    ;FA07: 27 03          ''.'
        AIM     #$F7,M0003               ;FA09: 71 F7 03       'q..'
ZFA0C   AIM     #$EF,M0002               ;FA0C: 71 EF 02       'q..'
        LDAA    #$03                     ;FA0F: 86 03          '..'
        LDAB    #$0E                     ;FA11: C6 0E          '..'
        JSR     opn_write                ;FA13: BD F4 90       '...'   io a
        AIM     #$FB,M0008               ;FA16: 71 FB 08       'q..'   disable TOI
        JMP     ZF869                    ;FA19: 7E F8 69       '~.i'
ZFA1C   LDX     #M000A                   ;FA1C: CE 00 0A       '...'
ZFA1F   TIM     #$01,already_playing     ;FA1F: 7B 01 B4       '{..'
        BEQ     ZFA27                    ;FA22: 27 03          ''.'
        JMP     ZFA30                    ;FA24: 7E FA 30       '~.0'
ZFA27   JSR     spin_delay_100ms         ;FA27: BD F7 2A       '..*'
        DEX                              ;FA2A: 09             '.'
        BNE     ZFA1F                    ;FA2B: 26 F2          '&.'
        JMP     ZF9FF                    ;FA2D: 7E F9 FF       '~..'
ZFA30   LDAA    #$00                     ;FA30: 86 00          '..'
        STAA    opn_ch                   ;FA32: 97 86          '..'
        JSR     opn_keyoff               ;FA34: BD F5 D2       '...'
        INC     >opn_ch                  ;FA37: 7C 00 86       '|..'
        JSR     opn_keyoff               ;FA3A: BD F5 D2       '...'
        INC     >opn_ch                  ;FA3D: 7C 00 86       '|..'
        JSR     opn_keyoff               ;FA40: BD F5 D2       '...'
        LDAA    #$28                     ;FA43: 86 28          '.('
        LDAB    #$27                     ;FA45: C6 27          '.''
        JSR     opn_write                ;FA47: BD F4 90       '...'   timer ab ctl 3ch mode
        LDX     #M0005                   ;FA4A: CE 00 05       '...'
ZFA4D   JSR     spin_delay_100ms         ;FA4D: BD F7 2A       '..*'
        DEX                              ;FA50: 09             '.'
        BNE     ZFA4D                    ;FA51: 26 FA          '&.'
        LDAA    #$03                     ;FA53: 86 03          '..'
        LDAB    #$0E                     ;FA55: C6 0E          '..'
        JSR     opn_write                ;FA57: BD F4 90       '...'   io a
        AIM     #$FB,M0008               ;FA5A: 71 FB 08       'q..'   disable TOI
        CLRA                             ;FA5D: 4F             'O'
        STAA    track1_note_len          ;FA5E: 97 8C          '..'
        STAA    track2_note_len          ;FA60: 97 8D          '..'
        STAA    track3_note_len          ;FA62: 97 8E          '..'
        STAA    track1_kon_len           ;FA64: 97 8F          '..'
        STAA    track2_kon_len           ;FA66: 97 90          '..'
        STAA    track3_kon_len           ;FA68: 97 91          '..'
        STAA    unk_M00BE                ;FA6A: 97 BE          '..'
        STAA    M00C1                    ;FA6C: 97 C1          '..'
        STAA    M00BF                    ;FA6E: 97 BF          '..'
        STAA    M00C0                    ;FA70: 97 C0          '..'
        STAA    already_playing          ;FA72: 97 B4          '..'
        STAA    int_flag                 ;FA74: 97 B3          '..'
        JMP     ZF937                    ;FA76: 7E F9 37       '~.7'
ZFA79   LDAB    opn_ch                   ;FA79: D6 86          '..'
        ADDB    #$30                     ;FA7B: CB 30          '.0'
        CLRA                             ;FA7D: 4F             'O'
        STAA    patch_upload_tmp         ;FA7E: 97 92          '..'
        STX     unk_M00BA                ;FA80: DF BA          '..'
ZFA82   LDAA    ,X                       ;FA82: A6 00          '..'
        JSR     opn_write                ;FA84: BD F4 90       '...'   dt/mul
        INCB                             ;FA87: 5C             '\'
        INCB                             ;FA88: 5C             '\'
        INCB                             ;FA89: 5C             '\'
        INCB                             ;FA8A: 5C             '\'
        INX                              ;FA8B: 08             '.'
        INC     >patch_upload_tmp        ;FA8C: 7C 00 92       '|..'
        LDAA    patch_upload_tmp         ;FA8F: 96 92          '..'
        CMPA    #$18                     ;FA91: 81 18          '..'
        BNE     ZFA82                    ;FA93: 26 ED          '&.'
        LDAB    opn_ch                   ;FA95: D6 86          '..'
        ADDB    #$B0                     ;FA97: CB B0          '..'
        LDAA    ,X                       ;FA99: A6 00          '..'
        JSR     opn_write                ;FA9B: BD F4 90       '...'   fb/conn
        LDX     unk_M00BA                ;FA9E: DE BA          '..'
        LDAA    $04,X                    ;FAA0: A6 04          '..'
        STAA    tl_op1                   ;FAA2: 97 A2          '..'
        LDAA    $05,X                    ;FAA4: A6 05          '..'
        STAA    tl_op3                   ;FAA6: 97 A4          '..'
        LDAA    $06,X                    ;FAA8: A6 06          '..'
        STAA    tl_op2                   ;FAAA: 97 A3          '..'
        LDAA    $07,X                    ;FAAC: A6 07          '..'
        STAA    tl_op4                   ;FAAE: 97 A5          '..'
        LDAA    $18,X                    ;FAB0: A6 18          '..'
        ANDA    #$07                     ;FAB2: 84 07          '..'
        LDX     #fb_algo_base            ;FAB4: CE 00 93       '...'
        JSR     add_opn_ch_x             ;FAB7: BD F7 1D       '...'
        STAA    ,X                       ;FABA: A7 00          '..'
        LDAA    tl_op1                   ;FABC: 96 A2          '..'
        LDX     #tl_op1_base             ;FABE: CE 00 96       '...'
        JSR     add_opn_ch_x             ;FAC1: BD F7 1D       '...'
        STAA    ,X                       ;FAC4: A7 00          '..'
        LDAA    tl_op2                   ;FAC6: 96 A3          '..'
        LDX     #tl_op2_base             ;FAC8: CE 00 99       '...'
        JSR     add_opn_ch_x             ;FACB: BD F7 1D       '...'
        STAA    ,X                       ;FACE: A7 00          '..'
        LDAA    tl_op3                   ;FAD0: 96 A4          '..'
        LDX     #tl_op3_base             ;FAD2: CE 00 9C       '...'
        JSR     add_opn_ch_x             ;FAD5: BD F7 1D       '...'
        STAA    ,X                       ;FAD8: A7 00          '..'
        LDAA    tl_op4                   ;FADA: 96 A5          '..'
        LDX     #tl_op4_base             ;FADC: CE 00 9F       '...'
        JSR     add_opn_ch_x             ;FADF: BD F7 1D       '...'
        STAA    ,X                       ;FAE2: A7 00          '..'
        RTS                              ;FAE4: 39             '9'
ZFAE5   LDAA    unk_M00BE                ;FAE5: 96 BE          '..'
        BNE     ZFB26                    ;FAE7: 26 3D          '&='
        LDAA    #$FF                     ;FAE9: 86 FF          '..'
        LDAB    opn_timer_b              ;FAEB: D6 8A          '..'
        SBA                              ;FAED: 10             '.'
        LSRA                             ;FAEE: 44             'D'
        LSRA                             ;FAEF: 44             'D'
        LSRA                             ;FAF0: 44             'D'
        STAA    M008B                    ;FAF1: 97 8B          '..'
        LDAB    #$0F                     ;FAF3: C6 0F          '..'
        JSR     opn_read                 ;FAF5: BD F4 AF       '...'   reading tempo here for ml301
        LSRA                             ;FAF8: 44             'D'
        COMA                             ;FAF9: 43             'C'
        ANDA    #$0F                     ;FAFA: 84 0F          '..'
        CMPA    #$0A                     ;FAFC: 81 0A          '..'
        BGE     ZFB2D                    ;FAFE: 2C 2D          ',-'
        LDAB    opn_timer_b              ;FB00: D6 8A          '..'
        CMPA    #$05                     ;FB02: 81 05          '..'
        BEQ     ZFB26                    ;FB04: 27 20          '' '
        BMI     ZFB17                    ;FB06: 2B 0F          '+.'
ZFB08   CLC                              ;FB08: 0C             '.'
        ADDB    M008B                    ;FB09: DB 8B          '..'
        BCC     ZFB0F                    ;FB0B: 24 02          '$.'
        LDAB    #$FF                     ;FB0D: C6 FF          '..'
ZFB0F   DECA                             ;FB0F: 4A             'J'
        CMPA    #$05                     ;FB10: 81 05          '..'
        BNE     ZFB08                    ;FB12: 26 F4          '&.'
        TBA                              ;FB14: 17             '.'
        BRA     ZFB28                    ;FB15: 20 11          ' .'
ZFB17   CLC                              ;FB17: 0C             '.'
        SBCB    M008B                    ;FB18: D2 8B          '..'
        BCC     ZFB1E                    ;FB1A: 24 02          '$.'
        LDAB    #$00                     ;FB1C: C6 00          '..'
ZFB1E   INCA                             ;FB1E: 4C             'L'
        CMPA    #$05                     ;FB1F: 81 05          '..'
        BNE     ZFB17                    ;FB21: 26 F4          '&.'
        TBA                              ;FB23: 17             '.'
        BRA     ZFB28                    ;FB24: 20 02          ' .'
ZFB26   LDAA    opn_timer_b              ;FB26: 96 8A          '..'
ZFB28   LDAB    #$26                     ;FB28: C6 26          '.&'
        JSR     opn_write                ;FB2A: BD F4 90       '...'   timer b
ZFB2D   RTS                              ;FB2D: 39             '9'
ml301_setup_next_note_trk1 LDX     track1_loc_word          ;FB2E: DE 80          '..'
        LDAA    ,X                       ;FB30: A6 00          '..'
        CMPA    #$FE                     ;FB32: 81 FE          '..'
        BEQ     ZFB58                    ;FB34: 27 22          ''"'
        STAA    cur_note_freq            ;FB36: 97 A6          '..'
        LDAA    $01,X                    ;FB38: A6 01          '..'
        STAA    track1_note_len          ;FB3A: 97 8C          '..'
        LDAA    $02,X                    ;FB3C: A6 02          '..'
        STAA    track1_kon_len           ;FB3E: 97 8F          '..'
        LDAA    $03,X                    ;FB40: A6 03          '..'
        STAA    opn_tl_modifier          ;FB42: 97 A8          '..'
        INX                              ;FB44: 08             '.'
        INX                              ;FB45: 08             '.'
        INX                              ;FB46: 08             '.'
        INX                              ;FB47: 08             '.'
        STX     track1_loc_word          ;FB48: DF 80          '..'
        LDAA    track1_kon_len           ;FB4A: 96 8F          '..'
        BEQ     ZFB57                    ;FB4C: 27 09          ''.'
        JSR     opn_write_4op_tl         ;FB4E: BD F5 65       '..e'
        JSR     opn_write_freq           ;FB51: BD F5 DC       '...'
        JSR     opn_keyon                ;FB54: BD F5 C8       '...'
ZFB57   RTS                              ;FB57: 39             '9'
ZFB58   LDAA    #$FF                     ;FB58: 86 FF          '..'
        STAA    track1_is_finished       ;FB5A: 97 87          '..'
        RTS                              ;FB5C: 39             '9'
ml301_setup_next_note_trk1 LDX     track2_loc_word          ;FB5D: DE 82          '..'
        LDAA    ,X                       ;FB5F: A6 00          '..'
        CMPA    #$FE                     ;FB61: 81 FE          '..'
        BEQ     ZFB87                    ;FB63: 27 22          ''"'
        STAA    cur_note_freq            ;FB65: 97 A6          '..'
        LDAA    $01,X                    ;FB67: A6 01          '..'
        STAA    track2_note_len          ;FB69: 97 8D          '..'
        LDAA    $02,X                    ;FB6B: A6 02          '..'
        STAA    track2_kon_len           ;FB6D: 97 90          '..'
        LDAA    $03,X                    ;FB6F: A6 03          '..'
        STAA    opn_tl_modifier          ;FB71: 97 A8          '..'
        INX                              ;FB73: 08             '.'
        INX                              ;FB74: 08             '.'
        INX                              ;FB75: 08             '.'
        INX                              ;FB76: 08             '.'
        STX     track2_loc_word          ;FB77: DF 82          '..'
        LDAA    track2_kon_len           ;FB79: 96 90          '..'
        BEQ     ZFB86                    ;FB7B: 27 09          ''.'
        JSR     opn_write_4op_tl         ;FB7D: BD F5 65       '..e'
        JSR     opn_write_freq           ;FB80: BD F5 DC       '...'
        JSR     opn_keyon                ;FB83: BD F5 C8       '...'
ZFB86   RTS                              ;FB86: 39             '9'
ZFB87   LDAA    #$FF                     ;FB87: 86 FF          '..'
        STAA    track2_is_finished       ;FB89: 97 88          '..'
        RTS                              ;FB8B: 39             '9'
ml301_setup_next_note_trk1 LDX     track3_loc_word          ;FB8C: DE 84          '..'
        LDAA    ,X                       ;FB8E: A6 00          '..'
        CMPA    #$FE                     ;FB90: 81 FE          '..'
        BEQ     ZFBB6                    ;FB92: 27 22          ''"'
        STAA    cur_note_freq            ;FB94: 97 A6          '..'
        LDAA    $01,X                    ;FB96: A6 01          '..'
        STAA    track3_note_len          ;FB98: 97 8E          '..'
        LDAA    $02,X                    ;FB9A: A6 02          '..'
        STAA    track3_kon_len           ;FB9C: 97 91          '..'
        LDAA    $03,X                    ;FB9E: A6 03          '..'
        STAA    opn_tl_modifier          ;FBA0: 97 A8          '..'
        INX                              ;FBA2: 08             '.'
        INX                              ;FBA3: 08             '.'
        INX                              ;FBA4: 08             '.'
        INX                              ;FBA5: 08             '.'
        STX     track3_loc_word          ;FBA6: DF 84          '..'
        LDAA    track3_kon_len           ;FBA8: 96 91          '..'
        BEQ     ZFBB5                    ;FBAA: 27 09          ''.'
        JSR     opn_write_4op_tl         ;FBAC: BD F5 65       '..e'
        JSR     opn_write_freq           ;FBAF: BD F5 DC       '...'
        JSR     opn_keyon                ;FBB2: BD F5 C8       '...'
ZFBB5   RTS                              ;FBB5: 39             '9'
ZFBB6   LDAA    #$FF                     ;FBB6: 86 FF          '..'
        STAA    track3_is_finished       ;FBB8: 97 89          '..'
        RTS                              ;FBBA: 39             '9'
ml301_swi_isr PSHA                             ;FBBB: 36             '6'
        PSHB                             ;FBBC: 37             '7'
        PSHX                             ;FBBD: 3C             '<'
        LDAA    M00C1                    ;FBBE: 96 C1          '..'
        BNE     ZFBCC                    ;FBC0: 26 0A          '&.'
        TIM     #$02,M0002               ;FBC2: 7B 02 02       '{..'
        BEQ     ZFBD5                    ;FBC5: 27 0E          ''.'
        TIM     #$08,M0002               ;FBC7: 7B 08 02       '{..'
        BEQ     ZFBE2                    ;FBCA: 27 16          ''.'
ZFBCC   LDAA    M0008                    ;FBCC: 96 08          '..'    clear TOF
        LDAA    M0009                    ;FBCE: 96 09          '..'    clear TOF
        PULX                             ;FBD0: 38             '8'
        PULB                             ;FBD1: 33             '3'
        PULA                             ;FBD2: 32             '2'
        CLI                              ;FBD3: 0E             '.'
        RTI                              ;FBD4: 3B             ';'
ZFBD5   LDAA    M00BF                    ;FBD5: 96 BF          '..'
        BEQ     ZFBEF                    ;FBD7: 27 16          ''.'
        INC     >already_playing         ;FBD9: 7C 00 B4       '|..'
        DEC     >M00BF                   ;FBDC: 7A 00 BF       'z..'
        JMP     ZFBCC                    ;FBDF: 7E FB CC       '~..'
ZFBE2   LDAA    M00C0                    ;FBE2: 96 C0          '..'
        BEQ     ZFBF5                    ;FBE4: 27 0F          ''.'
        INC     >already_playing         ;FBE6: 7C 00 B4       '|..'
        DEC     >M00C0                   ;FBE9: 7A 00 C0       'z..'
        JMP     ZFBCC                    ;FBEC: 7E FB CC       '~..'
ZFBEF   INC     >M00BF                   ;FBEF: 7C 00 BF       '|..'
        JMP     ZFBCC                    ;FBF2: 7E FB CC       '~..'
ZFBF5   INC     >M00C0                   ;FBF5: 7C 00 C0       '|..'
        JMP     ZFBCC                    ;FBF8: 7E FB CC       '~..'

        ORG     $FD00 

ml301_builtin_tunes FCB     $FD                      ;FD00: FD             '.'
        FCC     "6"                      ;FD01: 36             '6'
MFD02   FCB     $FD                      ;FD02: FD             '.'
        FCC     "v1AAA"                  ;FD03: 76 31 41 41 41 'v1AAA'
        FCB     $11,$11,$11,$11,$14,$14  ;FD08: 11 11 11 11 14 14 '......'
        FCB     $14,$14,$09,$09,$09,$09  ;FD0E: 14 14 09 09 09 09 '......'
        FCB     $0A,$0A,$0A,$0A,$86,$86  ;FD14: 0A 0A 0A 0A 86 86 '......'
        FCB     $86,$86,$07              ;FD1A: 86 86 07       '...'
        FCC     "W722"                   ;FD1D: 57 37 32 32    'W722'
        FCB     $1E,$1E,$07,$07,$1A,$1A  ;FD21: 1E 1E 07 07 1A 1A '......'
        FCB     $18,$18,$07,$06,$07,$07  ;FD27: 18 18 07 06 07 07 '......'
        FCB     $02,$02,$02,$02,$C3,$C3  ;FD2D: 02 02 02 02 C3 C3 '......'
        FCB     $D3,$D3                  ;FD33: D3 D3          '..'
        FCC     "$"                      ;FD35: 24             '$'
        FCB     $FD,$04,$FD,$04,$FD,$04  ;FD36: FD 04 FD 04 FD 04 '......'
        FCB     $FD                      ;FD3C: FD             '.'
        FCC     "J"                      ;FD3D: 4A             'J'
        FCB     $FD                      ;FD3E: FD             '.'
        FCC     "Z"                      ;FD3F: 5A             'Z'
        FCB     $FD                      ;FD40: FD             '.'
        FCC     "fJ"                     ;FD41: 66 4A          'fJ'
        FCB     $E2,$BE,$00,$FE,$FE,$FE  ;FD43: E2 BE 00 FE FE FE '......'
        FCB     $FE                      ;FD49: FE             '.'
        FCC     "F0-"                    ;FD4A: 46 30 2D       'F0-'
        FCB     $00                      ;FD4D: 00             '.'
        FCC     "J`"                     ;FD4E: 4A 60          'J`'
        FCB     $00,$7F                  ;FD50: 00 7F          '..'
        FCC     "V`^"                    ;FD52: 56 60 5E       'V`^'
        FCB     $00,$FE,$FE,$FE,$FE      ;FD55: 00 FE FE FE FE '.....'
        FCC     "F0"                     ;FD5A: 46 30          'F0'
        FCB     $00,$08                  ;FD5C: 00 08          '..'
        FCC     "J"                      ;FD5E: 4A             'J'
        FCB     $C0,$BE,$00,$FE,$FE,$FE  ;FD5F: C0 BE 00 FE FE FE '......'
        FCB     $FE                      ;FD65: FE             '.'
        FCC     "F0"                     ;FD66: 46 30          'F0'
        FCB     $00,$7F                  ;FD68: 00 7F          '..'
        FCC     "J0"                     ;FD6A: 4A 30          'J0'
        FCB     $00,$7F                  ;FD6C: 00 7F          '..'
        FCC     "Q"                      ;FD6E: 51             'Q'
        FCB     $90,$8E,$00,$FE,$FE,$FE  ;FD6F: 90 8E 00 FE FE FE '......'
        FCB     $FE,$FD,$1D,$FD,$1D,$FD  ;FD75: FE FD 1D FD 1D FD '......'
        FCB     $1D,$FD,$8A,$FD,$E6,$FE  ;FD7B: 1D FD 8A FD E6 FE '......'
        FCC     "F"                      ;FD81: 46             'F'
        FCB     $00,$BC,$00,$00,$FE,$FE  ;FD82: 00 BC 00 00 FE FE '......'
        FCB     $FE,$FE                  ;FD88: FE FE          '..'
        FCC     "+0-"                    ;FD8A: 2B 30 2D       '+0-'
        FCB     $00                      ;FD8D: 00             '.'
        FCC     ";0"                     ;FD8E: 3B 30          ';0'
        FCB     $00,$7F                  ;FD90: 00 7F          '..'
        FCC     ";0"                     ;FD92: 3B 30          ';0'
        FCB     $00,$7F,$26              ;FD94: 00 7F 26       '..&'
        FCC     "`\"                     ;FD97: 60 5C          '`\'
        FCB     $00                      ;FD99: 00             '.'
        FCC     "60"                     ;FD9A: 36 30          '60'
        FCB     $00,$7F                  ;FD9C: 00 7F          '..'
        FCC     "+0-"                    ;FD9E: 2B 30 2D       '+0-'
        FCB     $00                      ;FDA1: 00             '.'
        FCC     "60"                     ;FDA2: 36 30          '60'
        FCB     $00,$7F                  ;FDA4: 00 7F          '..'
        FCC     "60"                     ;FDA6: 36 30          '60'
        FCB     $00,$7F                  ;FDA8: 00 7F          '..'
        FCC     "60"                     ;FDAA: 36 30          '60'
        FCB     $00,$7F                  ;FDAC: 00 7F          '..'
        FCC     "60"                     ;FDAE: 36 30          '60'
        FCB     $00,$7F                  ;FDB0: 00 7F          '..'
        FCC     "60"                     ;FDB2: 36 30          '60'
        FCB     $00,$7F                  ;FDB4: 00 7F          '..'
        FCC     "A0"                     ;FDB6: 41 30          'A0'
        FCB     $00,$7F                  ;FDB8: 00 7F          '..'
        FCC     "A0"                     ;FDBA: 41 30          'A0'
        FCB     $00,$7F                  ;FDBC: 00 7F          '..'
        FCC     "10-"                    ;FDBE: 31 30 2D       '10-'
        FCB     $00                      ;FDC1: 00             '.'
        FCC     "A0"                     ;FDC2: 41 30          'A0'
        FCB     $00,$7F                  ;FDC4: 00 7F          '..'
        FCC     "A0"                     ;FDC6: 41 30          'A0'
        FCB     $00,$7F                  ;FDC8: 00 7F          '..'
        FCC     "A0"                     ;FDCA: 41 30          'A0'
        FCB     $00,$7F                  ;FDCC: 00 7F          '..'
        FCC     "A0"                     ;FDCE: 41 30          'A0'
        FCB     $00,$7F                  ;FDD0: 00 7F          '..'
        FCC     "10-"                    ;FDD2: 31 30 2D       '10-'
        FCB     $00                      ;FDD5: 00             '.'
        FCC     "A0"                     ;FDD6: 41 30          'A0'
        FCB     $00,$7F                  ;FDD8: 00 7F          '..'
        FCC     "+`\"                    ;FDDA: 2B 60 5C       '+`\'
        FCB     $00                      ;FDDD: 00             '.'
        FCC     ";0"                     ;FDDE: 3B 30          ';0'
        FCB     $00,$7F,$FE,$FE,$FE,$FE  ;FDE0: 00 7F FE FE FE FE '......'
        FCC     ";0"                     ;FDE6: 3B 30          ';0'
        FCB     $00,$7F                  ;FDE8: 00 7F          '..'
        FCC     "30-"                    ;FDEA: 33 30 2D       '30-'
        FCB     $00                      ;FDED: 00             '.'
        FCC     "C0"                     ;FDEE: 43 30          'C0'
        FCB     $00,$7F                  ;FDF0: 00 7F          '..'
        FCC     "C0"                     ;FDF2: 43 30          'C0'
        FCB     $00,$7F                  ;FDF4: 00 7F          '..'
        FCC     "C0"                     ;FDF6: 43 30          'C0'
        FCB     $00,$7F                  ;FDF8: 00 7F          '..'
        FCC     "C0"                     ;FDFA: 43 30          'C0'
        FCB     $00,$7F                  ;FDFC: 00 7F          '..'
        FCC     "C0"                     ;FDFE: 43 30          'C0'
        FCB     $00,$7F                  ;FE00: 00 7F          '..'
        FCC     "C0"                     ;FE02: 43 30          'C0'
        FCB     $00,$7F                  ;FE04: 00 7F          '..'
        FCC     "30-"                    ;FE06: 33 30 2D       '30-'
        FCB     $00                      ;FE09: 00             '.'
        FCC     "C0"                     ;FE0A: 43 30          'C0'
        FCB     $00,$7F                  ;FE0C: 00 7F          '..'
        FCC     "C0"                     ;FE0E: 43 30          'C0'
        FCB     $00,$7F                  ;FE10: 00 7F          '..'
        FCC     "C0"                     ;FE12: 43 30          'C0'
        FCB     $00,$7F                  ;FE14: 00 7F          '..'
        FCC     "30-"                    ;FE16: 33 30 2D       '30-'
        FCB     $00                      ;FE19: 00             '.'
        FCC     "C0"                     ;FE1A: 43 30          'C0'
        FCB     $00,$7F                  ;FE1C: 00 7F          '..'
        FCC     "C0"                     ;FE1E: 43 30          'C0'
        FCB     $00,$7F,$26              ;FE20: 00 7F 26       '..&'
        FCC     "`\"                     ;FE23: 60 5C          '`\'
        FCB     $00                      ;FE25: 00             '.'
        FCC     "60"                     ;FE26: 36 30          '60'
        FCB     $00,$7F,$26              ;FE28: 00 7F 26       '..&'
        FCC     "0-"                     ;FE2B: 30 2D          '0-'
        FCB     $00                      ;FE2D: 00             '.'
        FCC     "60"                     ;FE2E: 36 30          '60'
        FCB     $00,$7F                  ;FE30: 00 7F          '..'
        FCC     "60"                     ;FE32: 36 30          '60'
        FCB     $00,$7F                  ;FE34: 00 7F          '..'
        FCC     "60"                     ;FE36: 36 30          '60'
        FCB     $00,$7F                  ;FE38: 00 7F          '..'
        FCC     "60"                     ;FE3A: 36 30          '60'
        FCB     $00,$7F                  ;FE3C: 00 7F          '..'
        FCC     "60"                     ;FE3E: 36 30          '60'
        FCB     $00,$7F,$FE,$FE,$FE,$FE  ;FE40: 00 7F FE FE FE FE '......'
        FCC     ";0"                     ;FE46: 3B 30          ';0'
        FCB     $00,$7F                  ;FE48: 00 7F          '..'
        FCC     ";0"                     ;FE4A: 3B 30          ';0'
        FCB     $00,$7F                  ;FE4C: 00 7F          '..'
        FCC     "10-"                    ;FE4E: 31 30 2D       '10-'
        FCB     $00                      ;FE51: 00             '.'
        FCC     "A0"                     ;FE52: 41 30          'A0'
        FCB     $00,$7F                  ;FE54: 00 7F          '..'
        FCC     "A0"                     ;FE56: 41 30          'A0'
        FCB     $00,$7F                  ;FE58: 00 7F          '..'
        FCC     "A0"                     ;FE5A: 41 30          'A0'
        FCB     $00,$7F                  ;FE5C: 00 7F          '..'
        FCC     "A0"                     ;FE5E: 41 30          'A0'
        FCB     $00,$7F                  ;FE60: 00 7F          '..'
        FCC     "10-"                    ;FE62: 31 30 2D       '10-'
        FCB     $00                      ;FE65: 00             '.'
        FCC     "A0"                     ;FE66: 41 30          'A0'
        FCB     $00,$7F                  ;FE68: 00 7F          '..'
        FCC     "+`\"                    ;FE6A: 2B 60 5C       '+`\'
        FCB     $00                      ;FE6D: 00             '.'
        FCC     ";0"                     ;FE6E: 3B 30          ';0'
        FCB     $00,$7F                  ;FE70: 00 7F          '..'
        FCC     ";0"                     ;FE72: 3B 30          ';0'
        FCB     $00,$7F                  ;FE74: 00 7F          '..'
        FCC     "+0-"                    ;FE76: 2B 30 2D       '+0-'
        FCB     $00                      ;FE79: 00             '.'
        FCC     ";0"                     ;FE7A: 3B 30          ';0'
        FCB     $00,$7F                  ;FE7C: 00 7F          '..'
        FCC     ";0"                     ;FE7E: 3B 30          ';0'
        FCB     $00,$7F                  ;FE80: 00 7F          '..'
        FCC     ";0"                     ;FE82: 3B 30          ';0'
        FCB     $00,$7F                  ;FE84: 00 7F          '..'
        FCC     ";0"                     ;FE86: 3B 30          ';0'
        FCB     $00,$7F                  ;FE88: 00 7F          '..'
        FCC     ";0"                     ;FE8A: 3B 30          ';0'
        FCB     $00,$7F                  ;FE8C: 00 7F          '..'
        FCC     ";0"                     ;FE8E: 3B 30          ';0'
        FCB     $00,$7F                  ;FE90: 00 7F          '..'
        FCC     "30-"                    ;FE92: 33 30 2D       '30-'
        FCB     $00                      ;FE95: 00             '.'
        FCC     "C0"                     ;FE96: 43 30          'C0'
        FCB     $00,$7F                  ;FE98: 00 7F          '..'
        FCC     "C0"                     ;FE9A: 43 30          'C0'
        FCB     $00,$7F                  ;FE9C: 00 7F          '..'
        FCC     "C0"                     ;FE9E: 43 30          'C0'
        FCB     $00,$7F,$FE,$FE,$FE,$FE  ;FEA0: 00 7F FE FE FE FE '......'
        STX     MFFFF                    ;FEA6: FF FF FF       '...'
        STX     MFFFF                    ;FEA9: FF FF FF       '...'
        STX     MFFFF                    ;FEAC: FF FF FF       '...'
        STX     MFFFF                    ;FEAF: FF FF FF       '...'
        STX     MFFFF                    ;FEB2: FF FF FF       '...'
        STX     MFFFF                    ;FEB5: FF FF FF       '...'
        STX     MFFFF                    ;FEB8: FF FF FF       '...'
        STX     MFFFF                    ;FEBB: FF FF FF       '...'
        STX     MFFFF                    ;FEBE: FF FF FF       '...'
        STX     MFFFF                    ;FEC1: FF FF FF       '...'
        STX     MFFFF                    ;FEC4: FF FF FF       '...'
        STX     MFFFF                    ;FEC7: FF FF FF       '...'
        STX     MFFFF                    ;FECA: FF FF FF       '...'
        STX     MFFFF                    ;FECD: FF FF FF       '...'
        STX     MFFFF                    ;FED0: FF FF FF       '...'
        STX     MFFFF                    ;FED3: FF FF FF       '...'
        STX     MFFFF                    ;FED6: FF FF FF       '...'
        STX     MFFFF                    ;FED9: FF FF FF       '...'
        STX     MFFFF                    ;FEDC: FF FF FF       '...'
        STX     MFFFF                    ;FEDF: FF FF FF       '...'
        STX     MFFFF                    ;FEE2: FF FF FF       '...'
        STX     MFFFF                    ;FEE5: FF FF FF       '...'
        STX     MFFFF                    ;FEE8: FF FF FF       '...'
        STX     MFFFF                    ;FEEB: FF FF FF       '...'
        STX     MFFFF                    ;FEEE: FF FF FF       '...'
        STX     MFFFF                    ;FEF1: FF FF FF       '...'
        STX     MFFFF                    ;FEF4: FF FF FF       '...'
        STX     MFFFF                    ;FEF7: FF FF FF       '...'
        STX     MFFFF                    ;FEFA: FF FF FF       '...'
        STX     MFFFF                    ;FEFD: FF FF FF       '...'
        STX     MFFFF                    ;FF00: FF FF FF       '...'
        STX     MFFFF                    ;FF03: FF FF FF       '...'
        STX     MFFFF                    ;FF06: FF FF FF       '...'
        STX     MFFFF                    ;FF09: FF FF FF       '...'
        STX     MFFFF                    ;FF0C: FF FF FF       '...'
        STX     MFFFF                    ;FF0F: FF FF FF       '...'
        STX     MFFFF                    ;FF12: FF FF FF       '...'
        STX     MFFFF                    ;FF15: FF FF FF       '...'
        STX     MFFFF                    ;FF18: FF FF FF       '...'
        STX     MFFFF                    ;FF1B: FF FF FF       '...'
        STX     MFFFF                    ;FF1E: FF FF FF       '...'
        STX     MFFFF                    ;FF21: FF FF FF       '...'
        STX     MFFFF                    ;FF24: FF FF FF       '...'
        STX     MFFFF                    ;FF27: FF FF FF       '...'
        STX     MFFFF                    ;FF2A: FF FF FF       '...'
        STX     MFFFF                    ;FF2D: FF FF FF       '...'
        STX     MFFFF                    ;FF30: FF FF FF       '...'
        STX     MFFFF                    ;FF33: FF FF FF       '...'
        STX     MFFFF                    ;FF36: FF FF FF       '...'
        STX     MFFFF                    ;FF39: FF FF FF       '...'
        STX     MFFFF                    ;FF3C: FF FF FF       '...'
        STX     MFFFF                    ;FF3F: FF FF FF       '...'
        STX     MFFFF                    ;FF42: FF FF FF       '...'
        STX     MFFFF                    ;FF45: FF FF FF       '...'
        STX     MFFFF                    ;FF48: FF FF FF       '...'
        STX     MFFFF                    ;FF4B: FF FF FF       '...'
        STX     MFFFF                    ;FF4E: FF FF FF       '...'
        STX     MFFFF                    ;FF51: FF FF FF       '...'
        STX     MFFFF                    ;FF54: FF FF FF       '...'
        STX     MFFFF                    ;FF57: FF FF FF       '...'
        STX     MFFFF                    ;FF5A: FF FF FF       '...'
        STX     MFFFF                    ;FF5D: FF FF FF       '...'
        STX     MFFFF                    ;FF60: FF FF FF       '...'
        STX     MFFFF                    ;FF63: FF FF FF       '...'
        STX     MFFFF                    ;FF66: FF FF FF       '...'
        STX     MFFFF                    ;FF69: FF FF FF       '...'
        STX     MFFFF                    ;FF6C: FF FF FF       '...'
        STX     MFFFF                    ;FF6F: FF FF FF       '...'
        STX     MFFFF                    ;FF72: FF FF FF       '...'
        STX     MFFFF                    ;FF75: FF FF FF       '...'
        STX     MFFFF                    ;FF78: FF FF FF       '...'
        STX     MFFFF                    ;FF7B: FF FF FF       '...'
        STX     MFFFF                    ;FF7E: FF FF FF       '...'
        STX     MFFFF                    ;FF81: FF FF FF       '...'
        STX     MFFFF                    ;FF84: FF FF FF       '...'
        STX     MFFFF                    ;FF87: FF FF FF       '...'
        STX     MFFFF                    ;FF8A: FF FF FF       '...'
        STX     MFFFF                    ;FF8D: FF FF FF       '...'
        STX     MFFFF                    ;FF90: FF FF FF       '...'
        STX     MFFFF                    ;FF93: FF FF FF       '...'
        STX     MFFFF                    ;FF96: FF FF FF       '...'
        STX     MFFFF                    ;FF99: FF FF FF       '...'
        STX     MFFFF                    ;FF9C: FF FF FF       '...'
        STX     MFFFF                    ;FF9F: FF FF FF       '...'
        STX     MFFFF                    ;FFA2: FF FF FF       '...'
        STX     MFFFF                    ;FFA5: FF FF FF       '...'
        STX     MFFFF                    ;FFA8: FF FF FF       '...'
        STX     MFFFF                    ;FFAB: FF FF FF       '...'
        STX     MFFFF                    ;FFAE: FF FF FF       '...'
        STX     MFFFF                    ;FFB1: FF FF FF       '...'
        STX     MFFFF                    ;FFB4: FF FF FF       '...'
        STX     MFFFF                    ;FFB7: FF FF FF       '...'
        STX     MFFFF                    ;FFBA: FF FF FF       '...'
        STX     MFFFF                    ;FFBD: FF FF FF       '...'
        STX     MFFFF                    ;FFC0: FF FF FF       '...'
        STX     MFFFF                    ;FFC3: FF FF FF       '...'
        STX     MFFFF                    ;FFC6: FF FF FF       '...'
        STX     MFFFF                    ;FFC9: FF FF FF       '...'
        STX     MFFFF                    ;FFCC: FF FF FF       '...'
        STX     MFFFF                    ;FFCF: FF FF FF       '...'
        STX     MFFFF                    ;FFD2: FF FF FF       '...'
        STX     MFFFF                    ;FFD5: FF FF FF       '...'
        STX     MFFFF                    ;FFD8: FF FF FF       '...'
        STX     MFFFF                    ;FFDB: FF FF FF       '...'
        STX     MFFFF                    ;FFDE: FF FF FF       '...'
        STX     MFFFF                    ;FFE1: FF FF FF       '...'
        STX     MFFFF                    ;FFE4: FF FF FF       '...'
        STX     MFFFF                    ;FFE7: FF FF FF       '...'
        STX     MFFFF                    ;FFEA: FF FF FF       '...'
        STX     MFFFF                    ;FFED: FF FF FF       '...'
svec_DIV0 FDB     hdlr_RST                 ;FFF0: F0 18          '..'
svec_SWI3 FDB     hdlr_SWI3                ;FFF2: F7 7B          '.{'
svec_SWI2 FDB     hdlr_RST                 ;FFF4: F0 18          '..'
svec_FIRQ FDB     hdlr_RST                 ;FFF6: F0 18          '..'
svec_IRQ FDB     hdlr_IRQ                 ;FFF8: F7 37          '.7'
svec_SWI FDB     hdlr_RST                 ;FFFA: F0 18          '..'
svec_NMI FDB     hdlr_RST                 ;FFFC: F0 18          '..'
svec_RST FDB     hdlr_RST                 ;FFFE: F0 18          '..'

        END
